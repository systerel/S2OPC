## prj.conf
```kconfig
#######################
# CONFIGURATION FOR ZEPHYR PUBSUB SERVER demo
#######################
# Important Note:
# This file holds the board-unrelated configuration.
# For specificities, see file board/$boardname.conf (Automatically parsed by ZEPHYR)


#######################
# General config
CONFIG_NEWLIB_LIBC=y
CONFIG_MAIN_STACK_SIZE=8192

CONFIG_SOCKS=y
CONFIG_POSIX_MAX_FDS=16
CONFIG_INIT_STACKS=n

#####################
# Networking config

CONFIG_NETWORKING=y   				# Required for networking
CONFIG_NET_IPV4=y					# enables IPV4
CONFIG_NET_IPV4_AUTO=y				# enables ARP automatic answers
CONFIG_NET_TCP=y					# enables tcp stack
CONFIG_NET_SOCKETS=y				# enables sockets
CONFIG_NET_SOCKETS_POSIX_NAMES=y
CONFIG_NET_SOCKETS_POLL_MAX=5

CONFIG_NET_L2_DUMMY=y				# enables LOOPBACK card
CONFIG_NET_L2_ETHERNET=y			# enables ETHERNET card
CONFIG_NET_LOOPBACK=y				# enables LOOPBACK card
CONFIG_NET_ARP=y					# enables ARP
CONFIG_NET_MGMT=y
CONFIG_DNS_RESOLVER=y
CONFIG_NET_IPV4_IGMP=y

CONFIG_NET_DEFAULT_IF_ETHERNET=y	# 
CONFIG_NET_MAX_CONN=16
CONFIG_NET_MAX_CONTEXTS=16
CONFIG_NET_TX_STACK_SIZE=1500

CONFIG_NET_IF_MAX_IPV4_COUNT=2
CONFIG_NET_IF_MCAST_IPV4_ADDR_COUNT=8
CONFIG_NET_BUF_DATA_SIZE=512

CONFIG_NET_DRIVERS=y				# Required for communications
CONFIG_NET_CONFIG_SETTINGS=y
CONFIG_NET_CONFIG_NEED_IPV4=y
CONFIG_NET_PROMISCUOUS_MODE=y
CONFIG_NET_CONFIG_INIT_TIMEOUT=3
CONFIG_NET_NATIVE=y					# uses zephyr net stack
#> 2 connections => 5, For 3 cnx => 8 
CONFIG_NET_SOCKETS_POLL_MAX=8

# CONFIG_NET_CONFIG_MY_IPV6_ADDR="2001:db8:100::1"
# CONFIG_NET_CONFIG_PEER_IPV6_ADDR="2001:db8:100::2"

# Default IP on LOOPBACK
CONFIG_NET_CONFIG_MY_IPV4_ADDR="192.0.2.10"

# Default MASK on LOOPBACK
CONFIG_NET_CONFIG_MY_IPV4_NETMASK="255.255.255.0"

# Default GW on LOOPBACK
CONFIG_NET_CONFIG_MY_IPV4_GW="192.0.2.2"

CONFIG_SOPC_ETH_ADDRESS="192.168.42.21"
CONFIG_SOPC_ETH_GW="192.168.42.2"

# Number of IP on each card
CONFIG_NET_IF_UNICAST_IPV4_ADDR_COUNT=2

# Each CONFIG_NET_PKT_xX_COUNT costs 44 bytes
CONFIG_NET_PKT_RX_COUNT=12
CONFIG_NET_PKT_TX_COUNT=12
# Each CONFIG_NET_BUF_xX_COUNT costs 200 bytes (defaut = 36)
CONFIG_NET_BUF_RX_COUNT=18
CONFIG_NET_BUF_TX_COUNT=18


#####################
# MbedTLS
CONFIG_MBEDTLS=y
# CONFIG_MBEDTLS_BUILTIN=y
CONFIG_MBEDTLS_DTLS=y
CONFIG_MBEDTLS_GENPRIME_ENABLED=y
CONFIG_MBEDTLS_HEAP_SIZE=50000
CONFIG_MBEDTLS_HMAC_DRBG_ENABLED=y
CONFIG_MBEDTLS_ENTROPY_ENABLED=y
CONFIG_MBEDTLS_ENABLE_HEAP=y
CONFIG_MBEDTLS_KEY_EXCHANGE_PSK_ENABLED=y
CONFIG_MBEDTLS_KEY_EXCHANGE_RSA_PSK_ENABLED=y
CONFIG_MBEDTLS_PEM_CERTIFICATE_FORMAT=y
CONFIG_MBEDTLS_SSL_EXPORT_KEYS=y
CONFIG_MBEDTLS_SSL_MAX_CONTENT_LEN=2048

CONFIG_MBEDTLS_USER_CONFIG_ENABLE=y
CONFIG_MBEDTLS_USER_CONFIG_FILE="config_custom_mbedtls.h"

CONFIG_MBEDTLS_MEMORY_DEBUG=y

#####################
# S2OPC
# Activates S2OPC module
CONFIG_S2OPC=y
CONFIG_SOPC_PUBLISHER_PERIOD_US=10000
CONFIG_SOPC_SUBSCRIBER_PERIOD_US=10000
CONFIG_SOPC_PUBLISHER_OFFSET_US=2000

CONFIG_SOPC_PUBLISHER_ADDRESS="opc.udp://232.1.2.100:4840"
CONFIG_SOPC_SUBSCRIBER_ADDRESS="opc.udp://232.1.2.100:4840"
CONFIG_SOPC_PTP_SYNCH_DURATION=5

#####################
# for debug:
# CONFIG_SOPC_HELPER_IMPL_INSTRUM=y	# S2OPC ZEPHYR impl debug

CONFIG_LOG=y
CONFIG_DEBUG_COREDUMP=y
CONFIG_FAULT_DUMP=2
CONFIG_DEBUG_COREDUMP_BACKEND_LOGGING=y
CONFIG_DEBUG_COREDUMP_MEMORY_DUMP_MIN=y

# provides a console with net tools (after application returns)	
CONFIG_NET_SHELL=y

# required for CONFIG_CONSOLE_GETLINE
CONFIG_CONSOLE_SUBSYS=y

# provides "getline" feature to application
CONFIG_CONSOLE_GETLINE=y
# required for hwinfo_get_device_id
CONFIG_HWINFO=y         

#####################
# gPTP settings
CONFIG_NET_GPTP=y
CONFIG_NET_GPTP_BMCA_PRIORITY1=250
CONFIG_NET_GPTP_BMCA_PRIORITY2=250
#CONFIG_NET_GPTP_NEIGHBOR_PROP_DELAY_THR=100000
#CONFIG_NET_GPTP_STATISTICS=y
CONFIG_NET_GPTP_GM_CAPABLE=y
#CONFIG_NET_GPTP_LOG_LEVEL_DBG=y
```

## boards/mimxrt1064_evk.conf
```kconfig
# MIMX1064-evk-specific configuration

#####################
# ENTROPY
# Depends on target hability to provide entropy...
CONFIG_ENTROPY_GENERATOR=y
CONFIG_TEST_RANDOM_GENERATOR=y
CONFIG_SOC_SERIES_IMX_RT=y
CONFIG_SOC_SERIES_IMX_RT10XX=y

# IMX network won't receive MC UDP packet if CONFIG_ETH_MCUX_PROMISCUOUS_MODE is not set
# There may be a more clean solution, but it still has to be defined...
CONFIG_ETH_MCUX_PROMISCUOUS_MODE=y
```

## src/pubsub_config_static.c
```c
/*
 * Licensed to Systerel under one or more contributor license
 * agreements. See the NOTICE file distributed with this work
 * for additional information regarding copyright ownership.
 * Systerel licenses this file to you under the Apache
 * License, Version 2.0 (the "License"); you may not use this
 * file except in compliance with the License. You may obtain
 * a copy of the License at
 *
 *   http://www.apache.org/licenses/LICENSE-2.0
 *
 * Unless required by applicable law or agreed to in writing,
 * software distributed under the License is distributed on an
 * "AS IS" BASIS, WITHOUT WARRANTIES OR CONDITIONS OF ANY
 * KIND, either express or implied.  See the License for the
 * specific language governing permissions and limitations
 * under the License.
 */

#include "pubsub_config_static.h"

#include <assert.h>
#include <stdbool.h>
#include <string.h>

#ifndef CONFIG_SOPC_PUBLISHER_PERIOD_US
#error "CONFIG_SOPC_PUBLISHER_PERIOD_US is not defined!"
#endif

#ifndef CONFIG_SOPC_SUBSCRIBER_PERIOD_US
#error "CONFIG_SOPC_SUBSCRIBER_PERIOD_US is not defined!"
#endif

#ifndef CONFIG_SOPC_PUBLISHER_ADDRESS
#error "CONFIG_SOPC_PUBLISHER_ADDRESS is not defined!"
#endif

#ifndef CONFIG_SOPC_SUBSCRIBER_ADDRESS
#error "CONFIG_SOPC_SUBSCRIBER_ADDRESS is not defined!"
#endif

#define PUBSUB_VAR_STRING "ns=1;s=aString"
#define PUBSUB_VAR_BYTE "ns=1;s=aByte"
#define PUBSUB_VAR_UINT32 "ns=1;s=aUINT32"
#define PUBSUB_VAR_INT16 "ns=1;s=aINT16"
#define PUBSUB_VAR_BOOL "ns=1;s=aBOOL"
#define PUBSUB_VAR_STATUS "ns=1;s=aStatusCode"
#define NB_PUBSUB_VARS 6

#define PUBLISHER_ID 42
#define MESSAGE_ID 20
#define MESSAGE_VERSION 1

static SOPC_DataSetWriter* SOPC_PubSubConfig_SetPubMessageAt(SOPC_PubSubConnection* connection,
                                                             uint16_t index,
                                                             uint16_t messageId,
                                                             uint32_t version,
                                                             uint64_t interval,
                                                             int32_t offset,
                                                             SOPC_SecurityMode_Type securityMode)

{
    SOPC_WriterGroup* group = SOPC_PubSubConnection_Get_WriterGroup_At(connection, index);
    SOPC_WriterGroup_Set_Id(group, messageId);
    SOPC_WriterGroup_Set_Version(group, version);
    SOPC_WriterGroup_Set_PublishingInterval(group, interval);
    if (offset >=0)
    {
        SOPC_WriterGroup_Set_PublishingOffset(group, offset / 1000);
    }
    SOPC_WriterGroup_Set_SecurityMode(group, securityMode);

    // Create one DataSet Writer
    SOPC_WriterGroup_Allocate_DataSetWriter_Array(group, 1);
    SOPC_DataSetWriter* writer = SOPC_WriterGroup_Get_DataSetWriter_At(group, 0);
    SOPC_DataSetWriter_Set_Id(writer, messageId);
    return writer;
}

static SOPC_PublishedDataSet* SOPC_PubSubConfig_InitDataSet(SOPC_PubSubConfiguration* config,
                                                            uint16_t dataSetIndex,
                                                            SOPC_DataSetWriter* writer,
                                                            uint16_t nbVar)
{
    SOPC_PublishedDataSet* dataset = SOPC_PubSubConfiguration_Get_PublishedDataSet_At(config, dataSetIndex);
    SOPC_PublishedDataSet_Init(dataset, SOPC_PublishedDataItemsDataType, nbVar);
    SOPC_DataSetWriter_Set_DataSet(writer, dataset);

    return dataset;
}

static void SOPC_PubSubConfig_SetPubVariableAt(SOPC_PublishedDataSet* dataset,
                                               uint16_t index,
                                               char* strNodeId,
                                               SOPC_BuiltinId builtinType)
{
    SOPC_FieldMetaData* fieldmetadata = SOPC_PublishedDataSet_Get_FieldMetaData_At(dataset, index);
    SOPC_FieldMetaData_Set_ValueRank(fieldmetadata, -1);
    SOPC_FieldMetaData_Set_BuiltinType(fieldmetadata, builtinType);
    SOPC_PublishedVariable* publishedVar = SOPC_FieldMetaData_Get_PublishedVariable(fieldmetadata);
    assert(NULL != publishedVar);
    SOPC_NodeId* nodeId = SOPC_NodeId_FromCString(strNodeId, (int32_t) strlen(strNodeId));
    assert(NULL != nodeId);
    SOPC_PublishedVariable_Set_NodeId(publishedVar, nodeId);
    SOPC_PublishedVariable_Set_AttributeId(publishedVar,
                                           13); // Value => AttributeId=13
}

static SOPC_DataSetReader* SOPC_PubSubConfig_SetSubMessageAt(SOPC_PubSubConnection* connection,
                                                             uint16_t index,
                                                             uint32_t publisherId,
                                                             uint16_t messageId,
                                                             uint32_t version,
                                                             uint64_t interval,
                                                             SOPC_SecurityMode_Type securityMode)
{
    SOPC_ReaderGroup* readerGroup = SOPC_PubSubConnection_Get_ReaderGroup_At(connection, index);
    assert(readerGroup != NULL);
    SOPC_ReaderGroup_Set_SecurityMode(readerGroup, securityMode);
    bool allocSuccess = SOPC_ReaderGroup_Allocate_DataSetReader_Array(readerGroup, 1);
    SOPC_ReaderGroup_Set_PublisherId_UInteger(readerGroup, publisherId);
    if (allocSuccess)
    {
        SOPC_DataSetReader* reader = SOPC_ReaderGroup_Get_DataSetReader_At(readerGroup, 0);
        assert(reader != NULL);
        SOPC_DataSetReader_Set_DataSetWriterId(reader, messageId);
        SOPC_DataSetReader_Set_ReceiveTimeout(reader, 2 * interval);
        return reader;
    }
    return NULL;
}

static bool SOPC_PubSubConfig_SetSubNbVariables(SOPC_DataSetReader* reader, uint16_t nbVar)
{
    return SOPC_DataSetReader_Allocate_FieldMetaData_Array(reader, SOPC_TargetVariablesDataType, nbVar);
}

static void SOPC_PubSubConfig_SetSubVariableAt(SOPC_DataSetReader* reader,
                                               uint16_t index,
                                               char* strNodeId,
                                               SOPC_BuiltinId builtinType)
{
    SOPC_FieldMetaData* fieldmetadata = SOPC_DataSetReader_Get_FieldMetaData_At(reader, index);
    assert(fieldmetadata != NULL);

    /* fieldmetadata: type the field */
    SOPC_FieldMetaData_Set_ValueRank(fieldmetadata, -1);
    SOPC_FieldMetaData_Set_BuiltinType(fieldmetadata, builtinType);

    /* FieldTarget: link to the source/target data */
    SOPC_FieldTarget* fieldTarget = SOPC_FieldMetaData_Get_TargetVariable(fieldmetadata);
    assert(fieldTarget != NULL);
    SOPC_NodeId* nodeId = SOPC_NodeId_FromCString(strNodeId, (int32_t) strlen(strNodeId));
    SOPC_FieldTarget_Set_NodeId(fieldTarget, nodeId);
    SOPC_FieldTarget_Set_AttributeId(fieldTarget, 13); // Value => AttributeId=13
}

SOPC_PubSubConfiguration* SOPC_PubSubConfig_GetStatic(void)
{
    bool alloc = true;
    SOPC_PubSubConfiguration* config = SOPC_PubSubConfiguration_Create();
    SOPC_PubSubConnection* connection;

    /* 1 connection pub */
    alloc = SOPC_PubSubConfiguration_Allocate_PubConnection_Array(config, 1);

    /** connection pub 0 **/

    if (alloc)
    {
        // Set publisher id and address
        connection = SOPC_PubSubConfiguration_Get_PubConnection_At(config, 0);
        SOPC_PubSubConnection_Set_PublisherId_UInteger(connection, PUBLISHER_ID);
        alloc = SOPC_PubSubConnection_Set_Address(connection, CONFIG_SOPC_PUBLISHER_ADDRESS);
    }

    if (alloc)
    {
        // 2 pub messages
        alloc = SOPC_PubSubConnection_Allocate_WriterGroup_Array(connection, 1);
    }

    if (alloc)
    {
        // 2 published data sets
        alloc = SOPC_PubSubConfiguration_Allocate_PublishedDataSet_Array(config, 1);
    }

    /*** Pub Message ***/

    SOPC_DataSetWriter* writer = NULL;
    if (alloc)
    {
        // TODO : None or Sign&Encrypt
        writer = SOPC_PubSubConfig_SetPubMessageAt(
            connection, 0, MESSAGE_ID, MESSAGE_VERSION, CONFIG_SOPC_PUBLISHER_PERIOD_US / 1000,
            CONFIG_SOPC_PUBLISHER_OFFSET_US, SOPC_SecurityMode_None
            // SOPC_SecurityMode_SignAndEncrypt
        );
        alloc = NULL != writer;
    }

    SOPC_PublishedDataSet* dataset = NULL;
    if (alloc)
    {
        dataset = SOPC_PubSubConfig_InitDataSet(config, 0, writer, NB_PUBSUB_VARS);
        alloc = NULL != dataset;
    }
    if (alloc)
    {
        SOPC_PubSubConfig_SetPubVariableAt(dataset, 0, PUBSUB_VAR_STRING, SOPC_String_Id);
        SOPC_PubSubConfig_SetPubVariableAt(dataset, 1, PUBSUB_VAR_UINT32, SOPC_UInt32_Id);
        SOPC_PubSubConfig_SetPubVariableAt(dataset, 2, PUBSUB_VAR_INT16, SOPC_Int16_Id);
        SOPC_PubSubConfig_SetPubVariableAt(dataset, 3, PUBSUB_VAR_BOOL, SOPC_Boolean_Id);
        SOPC_PubSubConfig_SetPubVariableAt(dataset, 4, PUBSUB_VAR_STATUS, SOPC_StatusCode_Id);
        SOPC_PubSubConfig_SetPubVariableAt(dataset, 5, PUBSUB_VAR_BYTE, SOPC_Byte_Id);
    }

    /* 1 connection Sub */
    alloc = SOPC_PubSubConfiguration_Allocate_SubConnection_Array(config, 1);

    /** connection sub 0 **/

    if (alloc)
    {
        // Set subscriber id and address
        connection = SOPC_PubSubConfiguration_Get_SubConnection_At(config, 0);
        alloc = SOPC_PubSubConnection_Set_Address(connection, CONFIG_SOPC_SUBSCRIBER_ADDRESS);
    }

    if (alloc)
    {
        // 1 sub message
        alloc = SOPC_PubSubConnection_Allocate_ReaderGroup_Array(connection, 1);
    }

    SOPC_DataSetReader* reader = NULL;
    /*** Sub Message ***/

    if (alloc)
    {
        reader = SOPC_PubSubConfig_SetSubMessageAt(connection, 0, PUBLISHER_ID, MESSAGE_ID, MESSAGE_VERSION, 1000,
                                                   SOPC_SecurityMode_None);
        alloc = NULL != reader;
    }

    if (alloc)
    {
        alloc = SOPC_PubSubConfig_SetSubNbVariables(reader, NB_PUBSUB_VARS);
    }
    if (alloc)
    {
        SOPC_PubSubConfig_SetSubVariableAt(reader, 0, PUBSUB_VAR_STRING, SOPC_String_Id);
        SOPC_PubSubConfig_SetSubVariableAt(reader, 1, PUBSUB_VAR_UINT32, SOPC_UInt32_Id);
        SOPC_PubSubConfig_SetSubVariableAt(reader, 2, PUBSUB_VAR_INT16, SOPC_Int16_Id);
        SOPC_PubSubConfig_SetSubVariableAt(reader, 3, PUBSUB_VAR_BOOL, SOPC_Boolean_Id);
        SOPC_PubSubConfig_SetSubVariableAt(reader, 4, PUBSUB_VAR_STATUS, SOPC_StatusCode_Id);
        SOPC_PubSubConfig_SetSubVariableAt(reader, 5, PUBSUB_VAR_BYTE, SOPC_Byte_Id);
    }

    if (!alloc)
    {
        SOPC_PubSubConfiguration_Delete(config);
        return NULL;
    }

    return config;
}
```

## src/zephyr_pubsub_main.c
```c
/*
 * Licensed to Systerel under one or more contributor license
 * agreements. See the NOTICE file distributed with this work
 * for additional information regarding copyright ownership.
 * Systerel licenses this file to you under the Apache
 * License, Version 2.0 (the "License"); you may not use this
 * file except in compliance with the License. You may obtain
 * a copy of the License at
 *
 *   http://www.apache.org/licenses/LICENSE-2.0
 *
 * Unless required by applicable law or agreed to in writing,
 * software distributed under the License is distributed on an
 * "AS IS" BASIS, WITHOUT WARRANTIES OR CONDITIONS OF ANY
 * KIND, either express or implied.  See the License for the
 * specific language governing permissions and limitations
 * under the License.
 */

#include <kernel.h>
#include <limits.h>
#include <shell/shell.h>
#include <signal.h>
#include <stdio.h>

#include <stdlib.h>

#include "opcua_identifiers.h"
#include "opcua_statuscodes.h"
#include "sopc_assert.h"
#include "sopc_common.h"
#include "sopc_helper_string.h"
#include "sopc_logger.h"
#include "sopc_pub_scheduler.h"
#include "sopc_pubsub_local_sks.h"
#include "sopc_sub_scheduler.h"
#include "sopc_toolkit_config.h"
#include "sopc_user_app_itf.h"
#include "sopc_user_manager.h"

#include "cache.h"
#include "network_init.h"
#include "pubsub_config_static.h"
#include "static_security_data.h"
#include "threading_alt.h"

static SOPC_PubSubConfiguration* pPubSubConfig = NULL;
static SOPC_SubTargetVariableConfig* pTargetConfig = NULL;
static SOPC_PubSourceVariableConfig* pSourceConfig = NULL;
static bool gPubStarted = false;
static bool gSubStarted = false;

volatile int stopSignal = 0;
static void signal_stop_server(int sig)
{
    (void) sig;

    if (stopSignal != 0)
    {
        exit(1);
    }
    else
    {
        stopSignal = 1;
    }
}

static void cb_SetSubStatus(SOPC_PubSubState state)
{
    printk("New Pub/sub state: %d\n", (int) state);
}

/***************************************************/
// Callback in case of assert failure.
static void assert_UserCallback(const char* context)
{
    printk("ASSERT FAILED : <%p>\n", (void*) context);
    printk("Context: <%s>\n", context);
    stopSignal = 1;
    exit(1);
}

/***************************************************/
static void log_UserCallback(const char* context, const char* text)
{
    (void) context;
    if (NULL != text)
    {
        printk("%s\n", text);
    }
}

/***************************************************/
int main(int argc, char* const argv[])
{
    printk("\nBUILD DATE : " __DATE__ " " __TIME__ "\n");

    /* Signal handling: close the server gracefully when interrupted */
    signal(SIGINT, signal_stop_server);
    signal(SIGTERM, signal_stop_server);

    /* Parse command line arguments ? */
    (void) argc;
    (void) argv;

    SOPC_Assert_Set_UserCallback(&assert_UserCallback);

    bool netInit = Network_Initialize(NULL);
    SOPC_ASSERT(netInit == true);

    /* Initialize MbedTLS */
    tls_threading_initialize();

    /* Initialize S2OPC Server */
    const SOPC_Log_Configuration logCfg = {.logLevel = SOPC_LOG_LEVEL_WARNING,
                                           .logSystem = SOPC_LOG_SYSTEM_USER,
                                           .logSysConfig = {.userSystemLogConfig = {.doLog = &log_UserCallback}}};

    SOPC_ReturnStatus status = SOPC_Common_Initialize(logCfg);

    if (SOPC_STATUS_OK != status)
    {
        printf("Error while initializing logs\n");
    }

    // CONFIGURE PUBSUB
    pPubSubConfig = SOPC_PubSubConfig_GetStatic();
    if (NULL == pPubSubConfig)
    {
        return SOPC_STATUS_NOK;
    }

    /* Sub target configuration */
    if (SOPC_STATUS_OK == status)
    {
        pTargetConfig = SOPC_SubTargetVariableConfig_Create(&Cache_SetTargetVariables);
        if (NULL == pTargetConfig)
        {
            printf("# Error: Cannot create Sub configuration.\n");
            status = SOPC_STATUS_NOK;
        }
    }

    /* Pub target configuration */
    if (SOPC_STATUS_OK == status)
    {
        pSourceConfig = SOPC_PubSourceVariableConfig_Create(&Cache_GetSourceVariables);
        if (NULL == pSourceConfig)
        {
            printf("# Error: Cannot create Pub configuration.\n");
            status = SOPC_STATUS_NOK;
        }
    }

    if (SOPC_STATUS_OK == status)
    {
        // Configure SKS for PubSub
        SOPC_KeyBunch_init_static(pubSub_keySign, sizeof(pubSub_keySign), pubSub_keyEncrypt, sizeof(pubSub_keyEncrypt),
                                  pubSub_keyNonce, sizeof(pubSub_keyNonce));

        Cache_Initialize(pPubSubConfig);
    }

    while (!stopSignal)
    {
        k_sleep(K_MSEC(50));
    }

    SOPC_PubScheduler_Stop();
    SOPC_SubScheduler_Stop();
    Cache_Clear();
    SOPC_PubSourceVariableConfig_Delete(pSourceConfig);
    SOPC_SubTargetVariableConfig_Delete(pTargetConfig);
    SOPC_PubSubConfiguration_Delete(pPubSubConfig);

    printk("\r\nTEST ended\r\n");
    return 0;
}

/*---------------------------------------------------------------------------
 *                             NET SHELL CONFIGURATION
 *---------------------------------------------------------------------------*/
/***************************************************/
static int cmd_demo_info(const struct shell* shell, size_t argc, char** argv)
{
    ARG_UNUSED(argc);
    ARG_UNUSED(argv);

    printk("\nZephyr S2OPC PubSub demo status\n");
    printk("Server toolkit version: %s\n", SOPC_TOOLKIT_VERSION);
    if (pPubSubConfig != NULL)
    {
        uint32_t nbConn = SOPC_PubSubConfiguration_Nb_PubConnection(pPubSubConfig);
        printk("Pub connections: %d\n", nbConn);
        for (uint32_t iConn = 0; iConn < nbConn; iConn++)
        {
            SOPC_PubSubConnection* connx = SOPC_PubSubConfiguration_Get_PubConnection_At(pPubSubConfig, iConn);
            printk("  - RUNNING=%d\n", gPubStarted);
            printk("  - ADDR :%s\n", SOPC_PubSubConnection_Get_Address(connx));
        }

        nbConn = SOPC_PubSubConfiguration_Nb_SubConnection(pPubSubConfig);
        printk("Sub connections: %d\n", nbConn);
        for (uint32_t iConn = 0; iConn < nbConn; iConn++)
        {
            SOPC_PubSubConnection* connx = SOPC_PubSubConfiguration_Get_SubConnection_At(pPubSubConfig, iConn);
            connx = SOPC_PubSubConfiguration_Get_PubConnection_At(pPubSubConfig, 0);
            printk("  - RUNNING=%d\n", gSubStarted);
            printk("  - ADDR :%s\n", SOPC_PubSubConnection_Get_Address(connx));
        }
    }

    return 0;
}

/***************************************************/
static int cmd_demo_log(const struct shell* shell, size_t argc, char** argv)
{
    const char* param = (argc < 2 ? "" : argv[1]);
    if (0 == SOPC_strcmp_ignore_case(param, "debug"))
    {
        SOPC_Logger_SetTraceLogLevel(SOPC_LOG_LEVEL_DEBUG);
    }
    else if (0 == SOPC_strcmp_ignore_case(param, "info"))
    {
        SOPC_Logger_SetTraceLogLevel(SOPC_LOG_LEVEL_INFO);
    }
    else if (0 == SOPC_strcmp_ignore_case(param, "warning"))
    {
        SOPC_Logger_SetTraceLogLevel(SOPC_LOG_LEVEL_WARNING);
    }
    else if (0 == SOPC_strcmp_ignore_case(param, "error"))
    {
        SOPC_Logger_SetTraceLogLevel(SOPC_LOG_LEVEL_ERROR);
    }
    else
    {
        printk("\n Invalid log level (debug/info/warning/error).\n");
    }

    return 0;
}

/***************************************************/
static int cmd_demo_set(const struct shell* shell, size_t argc, char** argv)
{
    SOPC_ReturnStatus status = SOPC_STATUS_INVALID_PARAMETERS;
    const char* param1 = (argc < 3 ? "" : argv[1]);
    const char* param2 = (argc < 3 ? "" : argv[2]);

    SOPC_NodeId nid;
    status = SOPC_NodeId_InitializeFromCString(&nid, param1, strlen(param1));
    if (SOPC_STATUS_OK == status && param2[0] != 0)
    {
        bool result = false;
        Cache_Lock();
        SOPC_DataValue* dv = Cache_Get(&nid);
        if (NULL != dv)
        {
            result = Cache_UpdateVariant(dv->Value.BuiltInTypeId, &dv->Value.Value, param2);
        }
        Cache_Unlock();

        if (result)
        {
            printk("\n..OK!\n");
        }
        else
        {
            printk("\nUpdate failed.\n");
        }
    }
    else
    {
        printk("\n Invalid parameters.");
    }
    SOPC_NodeId_Clear(&nid);

    return 0;
}

/***************************************************/
static int cmd_demo_print(const struct shell* shell, size_t argc, char** argv)
{
    SOPC_ReturnStatus status = SOPC_STATUS_INVALID_PARAMETERS;
    const char* param = (argc < 2 ? NULL : argv[1]);

    if (param == NULL)
    {
        printk("\nDump full cache:\n");
        Cache_Dump();
    }
    else
    {
        SOPC_NodeId nid;
        status = SOPC_NodeId_InitializeFromCString(&nid, param, strlen(param));
        if (SOPC_STATUS_OK == status)
        {
            SOPC_DataValue dvc;
            SOPC_DataValue_Initialize(&dvc);

            // Only copy DV during Cache_Lock , to avoid too long Cache blocking
            Cache_Lock();
            SOPC_DataValue* dv = Cache_Get(&nid);
            if (NULL != dv)
            {
                status = SOPC_DataValue_Copy(&dvc, dv);
            }
            Cache_Unlock();

            // Now process with copy
            if (status == SOPC_STATUS_OK)
            {
                Cache_Dump_VarValue(&nid, &dvc);
            }

            SOPC_DataValue_Clear(&dvc);
        }
        else
        {
            printk("\n Invalid node id.\n");
        }
        SOPC_NodeId_Clear(&nid);
    }

    return 0;
}

/***************************************************/
static int cmd_demo_start(const struct shell* shell, size_t argc, char** argv)
{
    const char* param = (argc < 2 ? "" : argv[1]);

    if (0 == strcmp(param, "pub"))
    {
        // start pub
        bool bResult;
        bResult = SOPC_PubScheduler_Start(pPubSubConfig, pSourceConfig, CONFIG_SOPC_PUBLISHER_PRIORITY);
        if (!bResult)
        {
            printk("\r\nFailed to start Publisher!\r\n");
        }
        else
        {
            gPubStarted = true;
            printk("\r\nPublisher started\r\n");
        }
    }
    else if (0 == strcmp(param, "sub"))
    {
        // start sub
        bool bResult;
        bResult =
            SOPC_SubScheduler_Start(pPubSubConfig, pTargetConfig, cb_SetSubStatus, CONFIG_SOPC_SUBSCRIBER_PRIORITY);
        if (!bResult)
        {
            printk("\r\nFailed to start Subscriber!\r\n");
        }
        else
        {
            gSubStarted = true;
            printk("\r\nSubscriber started\r\n");
        }
    }
    else
    {
        printk("usage: %s [pub|sub]\n", argv[0]);
    }
    return 0;
}

/***************************************************/
static int cmd_demo_kill(const struct shell* shell, size_t argc, char** argv)
{
    ARG_UNUSED(argc);
    ARG_UNUSED(argv);
    stopSignal = 1;

    return 0;
}

/* Creating subcommands (level 1 command) array for command "demo". */
SHELL_STATIC_SUBCMD_SET_CREATE(sub_demo,
                               SHELL_CMD(info, NULL, "Show demo info", cmd_demo_info),
                               SHELL_CMD(start, NULL, "Start [pub|sub]", cmd_demo_start),
                               SHELL_CMD(print, NULL, "Print content of  <NodeId>", cmd_demo_print),
                               SHELL_CMD(set, NULL, "Set content of  <NodeId>", cmd_demo_set),
                               SHELL_CMD(log, NULL, "Set log level", cmd_demo_log),
                               SHELL_CMD(kill, NULL, "Kill demo", cmd_demo_kill),
                               SHELL_SUBCMD_SET_END);

/* Creating root (level 0) command "demo" */
SHELL_CMD_REGISTER(demo, &sub_demo, "Demo commands", NULL);
```
