## prj.conf
```kconfig
#######################
# CONFIGURATION FOR ZEPHYR PUBSUB SERVER demo
#######################
# Important Note:
# This file holds the board-unrelated configuration.
# For specificities, see file board/$boardname.conf (Automatically parsed by ZEPHYR)


#######################
# General config
CONFIG_NEWLIB_LIBC=y
CONFIG_MAIN_STACK_SIZE=8192

CONFIG_SOCKS=y
CONFIG_POSIX_MAX_FDS=16
CONFIG_INIT_STACKS=n

#####################
# Networking config

CONFIG_NETWORKING=y   				# Required for networking
CONFIG_NET_IPV4=y					# enables IPV4
CONFIG_NET_IPV4_AUTO=y				# enables ARP automatic answers
CONFIG_NET_TCP=y					# enables tcp stack
CONFIG_NET_SOCKETS=y				# enables sockets
CONFIG_NET_SOCKETS_POSIX_NAMES=y
CONFIG_NET_SOCKETS_POLL_MAX=5

CONFIG_NET_L2_DUMMY=y				# enables LOOPBACK card
CONFIG_NET_L2_ETHERNET=y			# enables ETHERNET card
CONFIG_NET_LOOPBACK=y				# enables LOOPBACK card
CONFIG_NET_ARP=y					# enables ARP
CONFIG_NET_MGMT=y
CONFIG_DNS_RESOLVER=y

CONFIG_NET_DEFAULT_IF_ETHERNET=y	# 
CONFIG_NET_MAX_CONN=16
CONFIG_NET_MAX_CONTEXTS=16
CONFIG_NET_TX_STACK_SIZE=1500

CONFIG_NET_IF_MAX_IPV4_COUNT=2
CONFIG_NET_IF_MCAST_IPV4_ADDR_COUNT=8
CONFIG_NET_BUF_DATA_SIZE=512

CONFIG_NET_DRIVERS=y				# Required for communications
CONFIG_NET_CONFIG_SETTINGS=y
CONFIG_NET_CONFIG_NEED_IPV4=y
CONFIG_NET_PROMISCUOUS_MODE=y
CONFIG_NET_CONFIG_INIT_TIMEOUT=3
CONFIG_NET_NATIVE=y					# uses zephyr net stack
#> 2 connections => 5, For 3 cnx => 8 
CONFIG_NET_SOCKETS_POLL_MAX=8

# ETH0 network configuration
CONFIG_SOPC_ETH_ADDRESS="192.168.42.22"
CONFIG_SOPC_ETH_NETMASK="255.255.255.0"
CONFIG_SOPC_ETH_GW="192.168.42.1"

# CONFIG_NET_CONFIG_MY_IPV6_ADDR="2001:db8:100::1"
# CONFIG_NET_CONFIG_PEER_IPV6_ADDR="2001:db8:100::2"

# Default IP on LOOPBACK
CONFIG_NET_CONFIG_MY_IPV4_ADDR="192.0.2.10"

# Default MASK on LOOPBACK
CONFIG_NET_CONFIG_MY_IPV4_NETMASK="255.255.255.0"

# Default GW on LOOPBACK
CONFIG_NET_CONFIG_MY_IPV4_GW="192.0.2.2"

# Number of IP on each card
CONFIG_NET_IF_UNICAST_IPV4_ADDR_COUNT=2

# Each CONFIG_NET_PKT_xX_COUNT costs 44 bytes
CONFIG_NET_PKT_RX_COUNT=12
CONFIG_NET_PKT_TX_COUNT=12
# Each CONFIG_NET_BUF_xX_COUNT costs 200 bytes (defaut = 36)
CONFIG_NET_BUF_RX_COUNT=18
CONFIG_NET_BUF_TX_COUNT=18


#####################
# MbedTLS
CONFIG_MBEDTLS=y
# CONFIG_MBEDTLS_BUILTIN=y
CONFIG_MBEDTLS_DTLS=y
CONFIG_MBEDTLS_GENPRIME_ENABLED=y
CONFIG_MBEDTLS_HEAP_SIZE=50000
CONFIG_MBEDTLS_HMAC_DRBG_ENABLED=y
CONFIG_MBEDTLS_ENTROPY_ENABLED=y
CONFIG_MBEDTLS_ENABLE_HEAP=y
CONFIG_MBEDTLS_KEY_EXCHANGE_PSK_ENABLED=y
CONFIG_MBEDTLS_KEY_EXCHANGE_RSA_PSK_ENABLED=y
CONFIG_MBEDTLS_PEM_CERTIFICATE_FORMAT=y
CONFIG_MBEDTLS_SSL_EXPORT_KEYS=y
CONFIG_MBEDTLS_SSL_MAX_CONTENT_LEN=2048

CONFIG_MBEDTLS_USER_CONFIG_ENABLE=y
CONFIG_MBEDTLS_USER_CONFIG_FILE="config_custom_mbedtls.h"

# CONFIG_MBEDTLS_MEMORY_DEBUG=y

CONFIG_MBEDTLS_ZEPHYR_ENTROPY=y

CONFIG_ENTROPY_GENERATOR=y
CONFIG_TEST_RANDOM_GENERATOR=y


#####################
# S2OPC
# Activates S2OPC module
CONFIG_S2OPC=y

#####################
# for debug:
# CONFIG_SOPC_HELPER_IMPL_INSTRUM=y	# S2OPC ZEPHYR impl debug
CONFIG_SOPC_ENDPOINT_ADDRESS="opc.tcp://192.168.10.23:4841"

# CONFIG_LOG=y
# CONFIG_DEBUG_COREDUMP=y
# CONFIG_FAULT_DUMP=2
# CONFIG_DEBUG_COREDUMP_BACKEND_LOGGING=y
# CONFIG_DEBUG_COREDUMP_MEMORY_DUMP_MIN=y

# provides a console with net tools (after application returns)	
CONFIG_NET_SHELL=y

# required for CONFIG_CONSOLE_GETLINE
CONFIG_CONSOLE_SUBSYS=y

# provides "getline" feature to application
CONFIG_CONSOLE_GETLINE=y
```

## boards/stm32h735g_disco.conf
```kconfig
# STM32H735-specific configuration

CONFIG_ETH_STM32_HAL=y
```

## src/zephyr_client_main.c
```c
/*
 * Licensed to Systerel under one or more contributor license
 * agreements. See the NOTICE file distributed with this work
 * for additional information regarding copyright ownership.
 * Systerel licenses this file to you under the Apache
 * License, Version 2.0 (the "License"); you may not use this
 * file except in compliance with the License. You may obtain
 * a copy of the License at
 *
 *   http://www.apache.org/licenses/LICENSE-2.0
 *
 * Unless required by applicable law or agreed to in writing,
 * software distributed under the License is distributed on an
 * "AS IS" BASIS, WITHOUT WARRANTIES OR CONDITIONS OF ANY
 * KIND, either express or implied.  See the License for the
 * specific language governing permissions and limitations
 * under the License.
 */

#include <limits.h>
#include <signal.h>
#include <stdio.h>
#include <stdlib.h>
#include <zephyr/kernel.h>
#include <zephyr/shell/shell.h>

#include "opcua_identifiers.h"
#include "opcua_statuscodes.h"
#include "sopc_assert.h"
#include "sopc_common.h"
#include "sopc_common_build_info.h"
#include "sopc_pub_scheduler.h"
#include "sopc_pubsub_local_sks.h"
#include "sopc_sub_scheduler.h"
#include "sopc_time.h"
#include "sopc_toolkit_config.h"
#include "sopc_user_app_itf.h"
#include "sopc_user_manager.h"

#include "libs2opc_client_cmds.h"
#include "libs2opc_common_config.h"

#include "network_init.h"
#include "static_security_data.h"
#include "threading_alt.h"

volatile int stopSignal = 0;
static int32_t gConfigurationId = -1;
static const char* epURL = CONFIG_SOPC_ENDPOINT_ADDRESS;

/***************************************************/
static void signal_stop_server(int sig)
{
    (void) sig;

    if (stopSignal != 0)
    {
        exit(1);
    }
    else
    {
        stopSignal = 1;
    }
}

/***************************************************/
SOPC_Build_Info SOPC_ClientServer_GetBuildInfo()
{
    static const SOPC_Build_Info sopc_client_server_build_info = {.buildVersion = SOPC_TOOLKIT_VERSION,
                                                                  .buildSrcCommit = "Not applicable",
                                                                  .buildDockerId = "",
                                                                  .buildBuildDate = ""};

    return sopc_client_server_build_info;
}

/***************************************************/
SOPC_Build_Info SOPC_Common_GetBuildInfo()
{
    static const SOPC_Build_Info sopc_common_build_info = {.buildVersion = SOPC_TOOLKIT_VERSION,
                                                           .buildSrcCommit = "Unknown_Revision",
                                                           .buildDockerId = "",
                                                           .buildBuildDate = ""};

    return sopc_common_build_info;
}

/***************************************************/
static void disconnect_callback(const uint32_t c_id)
{
    printf("===> connection #%d has been terminated!\n", c_id);
}

/***************************************************/
// Callback in case of assert failure.
static void assert_UserCallback(const char* context)
{
    printk("ASSERT FAILED : <%p>\n", (void*) context);
    printk("Context: <%s>\n", context);
    stopSignal = 1;
    exit(1);
}

/***************************************************/
static void log_UserCallback(const char* context, const char* text)
{
    (void) context;
    if (NULL != text)
    {
        printk("%s\n", text);
    }
}

/***************************************************/
static void client_tester(int connectionId)
{
    static const char* root_node_id = "ns=0;i=85";
    int res;
    printk("Browse Root.Objects\n");

    SOPC_ClientHelper_BrowseRequest browseRequest;
    SOPC_ClientHelper_BrowseResult browseResult;

    browseRequest.nodeId = "ns=0;i=85";                      // Root/Objects/
    browseRequest.direction = OpcUa_BrowseDirection_Forward; // forward
    browseRequest.referenceTypeId = "";                      // all reference types
    browseRequest.includeSubtypes = true;

    res = SOPC_ClientHelper_Browse(connectionId, &browseRequest, 1, &browseResult);
    if (0 == res)
    {
        SOPC_ClientHelper_BrowseRequest browseRequest;
        SOPC_ClientHelper_BrowseResult browseResult;

        browseRequest.nodeId = root_node_id;                     // Root/Objects/
        browseRequest.direction = OpcUa_BrowseDirection_Forward; // forward
        browseRequest.referenceTypeId = "";                      // all reference types
        browseRequest.includeSubtypes = true;

        /* Browse specified node */
        res = SOPC_ClientHelper_Browse(connectionId, &browseRequest, 1, &browseResult);

        if (0 == res)
        {
            printf("status: %d, nbOfResults: %d\n", browseResult.statusCode, browseResult.nbOfReferences);
            for (int32_t i = 0; i < browseResult.nbOfReferences; i++)
            {
                const SOPC_ClientHelper_BrowseResultReference* ref = &browseResult.references[i];
                printf("Item #%d\n", i);
                printf("- nodeId: %s\n", ref->nodeId);
                printf("- displayName: %s\n", ref->displayName);

                free(ref->nodeId);
                free(ref->displayName);
                free(ref->browseName);
                free(ref->referenceTypeId);
            }
            free(browseResult.references);
        }
        else
        {
            printf("Call to Browse service through client wrapper failed with return code: %d\n", res);
        }
    }
}

/***************************************************/
int main(int argc, char* const argv[])
{
    printk("\nBUILD DATE : " __DATE__ " " __TIME__ "\n");
    /* Signal handling: close the server gracefully when interrupted */
    signal(SIGINT, signal_stop_server);
    signal(SIGTERM, signal_stop_server);

    /* Parse command line arguments ? */
    (void) argc;
    (void) argv;
    SOPC_Assert_Set_UserCallback(&assert_UserCallback);

    bool netInit = Network_Initialize(NULL);
    SOPC_ReturnStatus status;
    SOPC_Log_Configuration logCfg = {.logLevel = SOPC_LOG_LEVEL_WARNING,
                                     .logSystem = SOPC_LOG_SYSTEM_USER,
                                     .logSysConfig = {.userSystemLogConfig = {.doLog = &log_UserCallback}}};

    SOPC_ASSERT(netInit == true);

    /* Initialize MbedTLS */
    tls_threading_initialize();

    printk("========================\n");
    printk("ZEPHYR S2OPC client demo\n");

    /* Initialize the toolkit */
    status = SOPC_CommonHelper_Initialize(&logCfg);
    SOPC_ASSERT(SOPC_STATUS_OK == status);

    SOPC_ClientHelper_Initialize(disconnect_callback);

    while (stopSignal == 0)
    {
        SOPC_Sleep(10);
    }
    printk("TEST ended\r\n");
    printk("==========\r\n");

    /* Close the toolkit */
    SOPC_ClientHelper_Finalize();
    return 0;
}

/*---------------------------------------------------------------------------
 *                             NET SHELL CONFIGURATION
 *---------------------------------------------------------------------------*/
#define BOOL_TO_TEXT(b) ((b) ? "YES" : "NO")

/***************************************************/
static int cmd_demo_info(const struct shell* shell, size_t argc, char** argv)
{
    ARG_UNUSED(argc);
    ARG_UNUSED(argv);

    printk("\nZephyr S2OPC client demo status\n");
    printk("Server endpoint       : %s\n", epURL);
    printk("Client toolkit version: %s\n", SOPC_TOOLKIT_VERSION);
    printk("Client configured     : %s\n", BOOL_TO_TEXT(gConfigurationId > 0));

    return 0;
}

/***************************************************/
static int cmd_demo_configure(const struct shell* shell, size_t argc, char** argv)
{
    SOPC_ClientHelper_Security security = {
        .security_policy = SOPC_SecurityPolicy_None_URI,
        .security_mode = OpcUa_MessageSecurityMode_None,
        .path_cert_auth = NULL,
        .path_crl = NULL,
        .path_cert_srv = NULL,
        .path_cert_cli = NULL,
        .path_key_cli = NULL,
        .policyId = "anonymous",
        .username = NULL,
        .password = NULL,
    }; // TODO !! no FS

    if (gConfigurationId > 0)
    {
        printk("\nClient already configured!\n");
        return 0;
    }

    if (argc > 1)
    {
        epURL = argv[1];
    }
    SOPC_ASSERT(epURL != NULL);

    SOPC_ClientHelper_EndpointConnection endpoint = {
        .endpointUrl = epURL,
        .serverUri = NULL,
        .reverseConnectionConfigId = 0,
    };

    /* connect to the endpoint */
    gConfigurationId = SOPC_ClientHelper_CreateConfiguration(&endpoint, &security, NULL);
    if (gConfigurationId <= 0)
    {
        printk("\nSOPC_ClientHelper_CreateConfiguration failed with code %d\r\n", gConfigurationId);
    }
    else
    {
        printk("\nCreated connection to %s\n", epURL);
    }
    return 0;
}

/***************************************************/
static int cmd_demo_connect(const struct shell* shell, size_t argc, char** argv)
{
    ARG_UNUSED(argc);
    ARG_UNUSED(argv);

    int32_t connectionId = SOPC_ClientHelper_CreateConnection(gConfigurationId);

    if (connectionId <= 0)
    {
        printk("\nSOPC_ClientHelper_CreateConnection failed with code %d\r\n", connectionId);
    }
    else
    {
        client_tester(connectionId);
        int32_t discoRes = SOPC_ClientHelper_Disconnect(connectionId);
        if (discoRes != 0)
        {
            printk("\nSOPC_ClientHelper_Disconnect failed with code %d\r\n", discoRes);
        }
    }
    return 0;
}

/***************************************************/
static int cmd_demo_kill(const struct shell* shell, size_t argc, char** argv)
{
    ARG_UNUSED(argc);
    ARG_UNUSED(argv);
    stopSignal = 1;

    return 0;
}
/* Creating subcommands (level 1 command) array for command "demo". */
SHELL_STATIC_SUBCMD_SET_CREATE(sub_demo,
                               SHELL_CMD(info, NULL, "Show demo info", cmd_demo_info),
                               SHELL_CMD(conf, NULL, "Configure client [<endpoint>]", cmd_demo_configure),
                               SHELL_CMD(conn, NULL, "Connect client", cmd_demo_connect),
                               SHELL_CMD(kill, NULL, "Quit", cmd_demo_kill),
                               SHELL_SUBCMD_SET_END);

/* Creating root (level 0) command "demo" */
SHELL_CMD_REGISTER(demo, &sub_demo, "Demo commands", NULL);
```
