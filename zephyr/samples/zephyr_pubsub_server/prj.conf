## CMakeLists.txt
```
cmake_minimum_required(VERSION 3.20.0)

find_package(Zephyr REQUIRED HINTS $ENV{ZEPHYR_BASE})

project(zephyr_pubsub_server)

SET(COMMON_SRC_DIR ${CMAKE_CURRENT_SOURCE_DIR}/../zephyr_common_src)

# =====================
# S2OPC CONFIGURATION
# =====================
# Note: The constants used within sample code (e.g WITH_STATIC_SECURITY_DATA) have to be
# redefined here because the values provided in s2opc/zephyr/CMakelist.txt only applies
# to "MODULE" source code reference in the same CMakelist.txt (typically : s2opc/src)
add_definitions (-DWITH_STATIC_SECURITY_DATA=1)
add_definitions (-DWITH_USER_ASSERT=1)
add_definitions (-UNDEBUG)
add_definitions (-Werror)

# =====================
# MBEDTLS SPECIFIC DEFS
# =====================
# MBEDTLS requires an applicative-defined configuration
# See CONFIG_MBEDTLS_USER_CONFIG_FILE
# This file is provided here

SET(mbedtls_config ${COMMON_SRC_DIR}/tls_config)
target_include_directories(app PRIVATE ${tls_config})
zephyr_include_directories(${mbedtls_config})

# =====================
# APP INCLUDES
# =====================

SET(app_headers ${CMAKE_CURRENT_SOURCE_DIR}/src
    ${COMMON_SRC_DIR}/tls_config
    ${COMMON_SRC_DIR}/)
target_include_directories(app PRIVATE ${app_headers})

# =====================
# APP SOURCES
# =====================

FILE(GLOB app_sources
     ${CMAKE_CURRENT_SOURCE_DIR}/src/*.c
     ${COMMON_SRC_DIR}/*.c
     ${COMMON_SRC_DIR}/tls_config/*.c)
target_sources(app PRIVATE ${app_sources})

# =====================
# ZEPHYR-GENERATED INCLUDES
# =====================

set(gen_dir ${ZEPHYR_BINARY_DIR}/include/generated/)
```

## Kconfig
```
# Private config options for mqtt-azure sample app

# Copyright (c) 2019 Intel Corporation
# SPDX-License-Identifier: Apache-2.0

mainmenu "Zephyr S2OPC server + PubSub demo"

config DEMO_CACHE_SYNCH_PERIOD_MS
    int "0"
    help
      Refresh period of Cache into AddressSpace. If set to 0, then updates are done
      as soon as possible on Subscriber reception.

source "Kconfig.zephyr"
```

## prj.conf
```kconfig
#######################
# CONFIGURATION FOR ZEPHYR PUBSUB SERVER demo
#######################
# Important Note:
# This file holds the board-unrelated configuration.
# For specificities, see file board/$boardname.conf (Automatically parsed by ZEPHYR)


#######################
# General config
CONFIG_NEWLIB_LIBC=y
CONFIG_MAIN_STACK_SIZE=8192
CONFIG_SHELL_STACK_SIZE=4096

CONFIG_SOCKS=y
CONFIG_POSIX_MAX_FDS=16
CONFIG_INIT_STACKS=n

#####################
# Networking config

CONFIG_NETWORKING=y   				# Required for networking
CONFIG_NET_IPV4=y					# enables IPV4
CONFIG_NET_IPV4_AUTO=y				# enables ARP automatic answers
CONFIG_NET_TCP=y					# enables tcp stack
CONFIG_NET_SOCKETS=y				# enables sockets
CONFIG_NET_SOCKETS_POSIX_NAMES=y
CONFIG_NET_SOCKETS_POLL_MAX=5

CONFIG_NET_L2_DUMMY=y				# enables LOOPBACK card
CONFIG_NET_L2_ETHERNET=y			# enables ETHERNET card
CONFIG_NET_LOOPBACK=y				# enables LOOPBACK card
CONFIG_NET_ARP=y					# enables ARP
CONFIG_NET_MGMT=y
CONFIG_DNS_RESOLVER=y

CONFIG_NET_DEFAULT_IF_ETHERNET=y	# 
CONFIG_NET_MAX_CONN=16
CONFIG_NET_MAX_CONTEXTS=16
CONFIG_NET_TX_STACK_SIZE=1500

CONFIG_NET_IF_MAX_IPV4_COUNT=2
CONFIG_NET_IF_MCAST_IPV4_ADDR_COUNT=8
CONFIG_NET_BUF_DATA_SIZE=512

CONFIG_NET_DRIVERS=y				# Required for communications
CONFIG_NET_CONFIG_SETTINGS=y
CONFIG_NET_CONFIG_NEED_IPV4=y
CONFIG_NET_PROMISCUOUS_MODE=y
CONFIG_NET_CONFIG_INIT_TIMEOUT=3
CONFIG_NET_NATIVE=y					# uses zephyr net stack
#> 2 connections => 5, For 3 cnx => 8 
CONFIG_NET_SOCKETS_POLL_MAX=8

# CONFIG_NET_CONFIG_MY_IPV6_ADDR="2001:db8:100::1"
# CONFIG_NET_CONFIG_PEER_IPV6_ADDR="2001:db8:100::2"

# Default IP on LOOPBACK
CONFIG_NET_CONFIG_MY_IPV4_ADDR="192.0.2.10"

# Default MASK on LOOPBACK
CONFIG_NET_CONFIG_MY_IPV4_NETMASK="255.255.255.0"

# Default GW on LOOPBACK
CONFIG_NET_CONFIG_MY_IPV4_GW="192.0.2.2"

CONFIG_SOPC_ETH_ADDRESS="192.168.42.21"
CONFIG_SOPC_ETH_GW="192.168.42.2"
# Number of IP on each card
CONFIG_NET_IF_UNICAST_IPV4_ADDR_COUNT=2

# Each CONFIG_NET_PKT_xX_COUNT costs 44 bytes
CONFIG_NET_PKT_RX_COUNT=12
CONFIG_NET_PKT_TX_COUNT=12
# Each CONFIG_NET_BUF_xX_COUNT costs 200 bytes (defaut = 36)
CONFIG_NET_BUF_RX_COUNT=18
CONFIG_NET_BUF_TX_COUNT=18


#####################
# MbedTLS
CONFIG_MBEDTLS=y
# CONFIG_MBEDTLS_BUILTIN=y
CONFIG_MBEDTLS_DTLS=y
CONFIG_MBEDTLS_GENPRIME_ENABLED=y
CONFIG_MBEDTLS_HEAP_SIZE=50000
CONFIG_MBEDTLS_HMAC_DRBG_ENABLED=y
CONFIG_MBEDTLS_ENTROPY_ENABLED=y
CONFIG_MBEDTLS_ENABLE_HEAP=y
CONFIG_MBEDTLS_KEY_EXCHANGE_PSK_ENABLED=y
CONFIG_MBEDTLS_KEY_EXCHANGE_RSA_PSK_ENABLED=y
CONFIG_MBEDTLS_PEM_CERTIFICATE_FORMAT=y
CONFIG_MBEDTLS_SSL_EXPORT_KEYS=y
CONFIG_MBEDTLS_SSL_MAX_CONTENT_LEN=2048

CONFIG_MBEDTLS_USER_CONFIG_ENABLE=y
CONFIG_MBEDTLS_USER_CONFIG_FILE="config_custom_mbedtls.h"

# CONFIG_MBEDTLS_MEMORY_DEBUG=y

CONFIG_MBEDTLS_ZEPHYR_ENTROPY=y

CONFIG_ENTROPY_GENERATOR=y
CONFIG_TEST_RANDOM_GENERATOR=y

#####################
# S2OPC
# Activates S2OPC module
CONFIG_S2OPC=y
CONFIG_SOPC_PUBLISHER_PERIOD_US=1000000
CONFIG_SOPC_SUBSCRIBER_PERIOD_US=1000000

CONFIG_SOPC_PUBLISHER_ADDRESS="opc.udp://232.1.2.100:4840"
CONFIG_SOPC_SUBSCRIBER_ADDRESS="opc.udp://232.1.2.101:4840"

#####################
# Demo-specific
CONFIG_DEMO_CACHE_SYNCH_PERIOD_MS=0

#####################
# for debug:
CONFIG_SOPC_HELPER_IMPL_INSTRUM=y	# S2OPC ZEPHYR impl debug
CONFIG_SOPC_ENDPOINT_ADDRESS="opc.tcp://192.168.42.21:4841"

# CONFIG_LOG=y
# CONFIG_DEBUG_COREDUMP=y
# CONFIG_FAULT_DUMP=2
# CONFIG_DEBUG_COREDUMP_BACKEND_LOGGING=y
# CONFIG_DEBUG_COREDUMP_MEMORY_DUMP_MIN=y

# provides a console with net tools (after application returns)	
CONFIG_SHELL=y
CONFIG_NET_SHELL=y

# required for CONFIG_CONSOLE_GETLINE
#CONFIG_CONSOLE_SUBSYS=y

# provides "getline" feature to application
#CONFIG_CONSOLE_GETLINE=y
CONFIG_REBOOT=y

#####################
# gPTP settings
# CONFIG_NET_GPTP=y
# CONFIG_NET_GPTP_STATISTICS=y
# CONFIG_NET_GPTP_GM_CAPABLE=y
```

## boards/mimxrt1064_evk.conf
```kconfig
# MIMX1064-evk-specific configuration

# This will allow MC reception
CONFIG_ETH_MCUX_PROMISCUOUS_MODE=y
 
CONFIG_DEMO_CACHE_SYNCH_PERIOD_MS=5000
#####################
# ENTROPY
# Depends on target hability to provide entropy...
CONFIG_ENTROPY_GENERATOR=y
CONFIG_TEST_RANDOM_GENERATOR=y
CONFIG_SOC_SERIES_IMX_RT=y
CONFIG_SOC_SERIES_IMX_RT10XX=y
```

## boards/stm32h735g_disco.conf
```kconfig
# STM32H735-specific configuration

CONFIG_ETH_STM32_HAL=y

# Invert configuration on STM735 to communicate with NXP
CONFIG_SOPC_PUBLISHER_ADDRESS="opc.udp://232.1.2.101:4840"
CONFIG_SOPC_SUBSCRIBER_ADDRESS="opc.udp://232.1.2.100:4840"


CONFIG_SOPC_ETH_ADDRESS="192.168.42.22"
CONFIG_SOPC_ENDPOINT_ADDRESS="opc.tcp://192.168.42.22:4841"

# Not supported yet:
# CONFIG_ETH_STM32_HAL_API_V2=y
```

## src/cache.c
```c
/*
 * Licensed to Systerel under one or more contributor license
 * agreements. See the NOTICE file distributed with this work
 * for additional information regarding copyright ownership.
 * Systerel licenses this file to you under the Apache
 * License, Version 2.0 (the "License"); you may not use this
 * file except in compliance with the License. You may obtain
 * a copy of the License at
 *
 *   http://www.apache.org/licenses/LICENSE-2.0
 *
 * Unless required by applicable law or agreed to in writing,
 * software distributed under the License is distributed on an
 * "AS IS" BASIS, WITHOUT WARRANTIES OR CONDITIONS OF ANY
 * KIND, either express or implied.  See the License for the
 * specific language governing permissions and limitations
 * under the License.
 */

#include <assert.h>
#include <stdio.h>
#include <stdlib.h>
#include <string.h>

#include "sopc_assert.h"
#include "sopc_helper_string.h"
#include "sopc_logger.h"
#include "sopc_mem_alloc.h"
#include "sopc_mutexes.h"
#include "sopc_time.h"

#include "cache.h"

#define SAFE_STRING(s) ((NULL == (s)) ? "<NULL>" : (s))
/**
 * The cache is a simple dictionnary { SOPC_NodeId* : SOPC_DataValue*}
 * The elements and keys are not referenced anywhere else, thus references must be cleared
 * when an item is removed.
 * Of course, keys and elements MUST be MALLOCed.
 */
SOPC_Dict* g_cache = NULL;
Mutex g_lock;
typedef struct
{
    SOPC_NodeId* nid;
    Cache_SourceVarListener* listener;
} ListenerNid;

static ListenerNid gListenerNid = {.nid = NULL, .listener = NULL};

static void free_datavalue(void* value)
{
    SOPC_DataValue_Clear(value);
    SOPC_Free(value);
}

static SOPC_VariantArrayType valueRankToArrayType(const int32_t valueRank)
{
    SOPC_VariantArrayType result = SOPC_VariantArrayType_SingleValue;
    if (valueRank < 0)
    {
        // Use Single value if possible
        result = SOPC_VariantArrayType_SingleValue;
    }
    else if (valueRank < 2)
    {
        // Use Array if possible
        result = SOPC_VariantArrayType_Array;
    }
    else if (valueRank == 2)
    {
        // Use Matrix
        result = SOPC_VariantArrayType_Matrix;
    }
    else
    {
        SOPC_ASSERT(false && "Cannot create variables with dimensions > 2");
    }
    return result;
}

bool Cache_UpdateVariant(SOPC_BuiltinId type, SOPC_VariantValue* variant, const char* value)
{
    SOPC_ASSERT(NULL != variant && NULL != value);

    bool result = true;
    int64_t iValue;
    if (value[0] == 0)
    {
        iValue = 0;
    }
    else if (SOPC_strncmp_ignore_case(value, "0x", 2) == 0)
    {
        iValue = (int64_t) strtoll(value + 2, NULL, 0x10);
    }
    else
    {
        iValue = (int64_t) strtoll(value, NULL, 10);
    }
    const float fValue = atof(value);

    switch (type)
    {
    case SOPC_Null_Id:
        result = false;
        break;
    case SOPC_Boolean_Id:
        variant->Boolean = (SOPC_Boolean) iValue;
        break;
    case SOPC_SByte_Id:
        variant->Sbyte = (SOPC_SByte) iValue;
        break;
    case SOPC_Byte_Id:
        variant->Byte = (SOPC_Byte) iValue;
        break;
    case SOPC_Int16_Id:
        variant->Int16 = (int16_t) iValue;
        break;
    case SOPC_UInt16_Id:
        variant->Uint16 = (uint16_t) iValue;
        break;
    case SOPC_Int32_Id:
        variant->Int32 = (int32_t) iValue;
        break;
    case SOPC_UInt32_Id:
        variant->Uint32 = (uint32_t) iValue;
        break;
    case SOPC_Int64_Id:
        variant->Int64 = (int64_t) iValue;
        break;
    case SOPC_UInt64_Id:
        variant->Uint64 = (uint64_t) iValue;
        break;
    case SOPC_Float_Id:
        variant->Floatv = (float) fValue;
        break;
    case SOPC_Double_Id:
        variant->Doublev = (double) fValue;
        break;
    case SOPC_String_Id:
        SOPC_String_InitializeFromCString(&variant->String, value);
        break;
    case SOPC_DateTime_Id:
        variant->Date = SOPC_Time_GetCurrentTimeUTC();
        break;
    case SOPC_ByteString_Id:
        SOPC_ByteString_InitializeFixedSize(&variant->Bstring, strlen(value));
        SOPC_ByteString_CopyFromBytes(&variant->Bstring, value, strlen(value));
        break;
    case SOPC_StatusCode_Id:
        variant->Status = (SOPC_StatusCode) iValue;
        break;
    case SOPC_Guid_Id:
    case SOPC_XmlElement_Id:
    case SOPC_NodeId_Id:
    case SOPC_ExpandedNodeId_Id:
    case SOPC_QualifiedName_Id:
    case SOPC_LocalizedText_Id:
    case SOPC_ExtensionObject_Id:
    case SOPC_DataValue_Id:
    case SOPC_DiagnosticInfo_Id:
    case SOPC_Variant_Id:
    default:
        result = false;
        break;
    }

    return result;
}

/* Create a new datavalue with a default false/0/now/empty value of given scalar built-in type */
static SOPC_DataValue* new_datavalue(SOPC_BuiltinId type, const SOPC_VariantArrayType arrayType)
{
    SOPC_DataValue* dv = SOPC_Calloc(1, sizeof(SOPC_DataValue));
    if (NULL == dv)
    {
        return NULL;
    }

    /* Note: for now, only the Variant part of the DataValue is used by the publisher */
    SOPC_DataValue_Initialize(dv);
    SOPC_Variant* var = &dv->Value;
    SOPC_Variant_Initialize(var);
    var->BuiltInTypeId = type;
    var->ArrayType = arrayType;

    switch (arrayType)
    {
    case SOPC_VariantArrayType_SingleValue:
        Cache_UpdateVariant(type, &var->Value, "");
        break;

    case SOPC_VariantArrayType_Array:
        // Set "Empty array"
        var->Value.Array.Length = 0;
        break;

    case SOPC_VariantArrayType_Matrix:
        var->Value.Matrix.Dimensions = 2;
        var->Value.Matrix.ArrayDimensions = SOPC_Calloc(2, sizeof(uint32_t));
        SOPC_ASSERT(var->Value.Matrix.ArrayDimensions != NULL);
        var->Value.Matrix.ArrayDimensions[0] = 0;
        var->Value.Matrix.ArrayDimensions[1] = 0;
        break;
    default:
        SOPC_ASSERT(false && "Cannot create default empty value for Matrixes with Dimensions > 2");
        break;
    }

    return dv;
}

bool Cache_Initialize(SOPC_PubSubConfiguration* config)
{
    if (NULL == config)
    {
        SOPC_Logger_TraceError(SOPC_LOG_MODULE_PUBSUB, "Cache initialization with NULL configuration");
        return false;
    }

    if (NULL != g_cache)
    {
        SOPC_Logger_TraceError(SOPC_LOG_MODULE_PUBSUB, "Cache already initialized");
        return false;
    }
    gListenerNid.nid = NULL;
    gListenerNid.listener = NULL;

    SOPC_ReturnStatus status = Mutex_Initialization(&g_lock);
    g_cache = SOPC_NodeId_Dict_Create(true, free_datavalue);
    bool res = SOPC_STATUS_OK == status && NULL != g_cache;

    /* Parse configuration and fill the cache with default values */
    /* NodeId is in the field metadata (target variable for subscriber and published variable for publisher)
     *  and fields are in DataSetMetaData, which is found in reader groups of subscriber connections,
     *  and in published data set for publishers */
    const uint32_t nbPubConnection = SOPC_PubSubConfiguration_Nb_PubConnection(config);
    for (uint32_t i = 0; res && i < nbPubConnection; ++i)
    {
        /* TODO: it might be shorter to directly Get_PublishedDataSet_At */
        const SOPC_PubSubConnection* connection = SOPC_PubSubConfiguration_Get_PubConnection_At(config, i);
        const uint16_t nbWriterGroup = SOPC_PubSubConnection_Nb_WriterGroup(connection);
        for (uint16_t j = 0; res && j < nbWriterGroup; ++j)
        {
            const SOPC_WriterGroup* group = SOPC_PubSubConnection_Get_WriterGroup_At(connection, j);
            const uint8_t nbDataSetWriter = SOPC_WriterGroup_Nb_DataSetWriter(group);
            for (uint8_t k = 0; res && k < nbDataSetWriter; ++k)
            {
                const SOPC_DataSetWriter* writer = SOPC_WriterGroup_Get_DataSetWriter_At(group, k);
                const SOPC_PublishedDataSet* dataset = SOPC_DataSetWriter_Get_DataSet(writer);
                const uint16_t nbFields = SOPC_PublishedDataSet_Nb_FieldMetaData(dataset);
                for (uint16_t l = 0; res && l < nbFields; ++l)
                {
                    const SOPC_FieldMetaData* metadata = SOPC_PublishedDataSet_Get_FieldMetaData_At(dataset, l);
                    const SOPC_BuiltinId type = SOPC_FieldMetaData_Get_BuiltinType(metadata);
                    const int32_t valueRank = SOPC_FieldMetaData_Get_ValueRank(metadata);

                    /* Retrieve and copy the NodeId for insertion in the Cache */
                    const SOPC_PublishedVariable* target = SOPC_FieldMetaData_Get_PublishedVariable(metadata);
                    const SOPC_NodeId* src = SOPC_PublishedVariable_Get_NodeId(target);
                    SOPC_NodeId* nid = SOPC_Calloc(1, sizeof(SOPC_NodeId));
                    res &= (NULL != nid);

                    if (res)
                    {
                        status = SOPC_NodeId_Copy(nid, src);
                        if (SOPC_STATUS_OK != status)
                        {
                            res = false;
                        }
                    }

                    /* Insert a DataValue initialized to a default value */
                    if (res)
                    {
                        SOPC_DataValue* dv = new_datavalue(type, valueRankToArrayType(valueRank));
                        res &= Cache_Set(nid, dv); /* Both will be freed by the cache */
                    }

                    if (res)
                    {
                        char* nid_str = SOPC_NodeId_ToCString(nid);
                        SOPC_Logger_TraceInfo(SOPC_LOG_MODULE_PUBSUB, "Cache: inserted %s of type %d", nid_str, type);
                        SOPC_Free(nid_str);
                    }
                    else
                    {
                        SOPC_Free(nid);
                    }
                }
            }
        }
    }

    const uint32_t nbSubConnection = SOPC_PubSubConfiguration_Nb_SubConnection(config);
    for (uint32_t i = 0; res && i < nbSubConnection; ++i)
    {
        const SOPC_PubSubConnection* connection = SOPC_PubSubConfiguration_Get_SubConnection_At(config, i);
        const uint16_t nbReaderGroup = SOPC_PubSubConnection_Nb_ReaderGroup(connection);
        for (uint16_t j = 0; res && j < nbReaderGroup; ++j)
        {
            const SOPC_ReaderGroup* readerGroup = SOPC_PubSubConnection_Get_ReaderGroup_At(connection, j);
            const uint8_t nbDataSetReader = SOPC_ReaderGroup_Nb_DataSetReader(readerGroup);
            for (uint8_t k = 0; res && k < nbDataSetReader; ++k)
            {
                const SOPC_DataSetReader* dataSetReader = SOPC_ReaderGroup_Get_DataSetReader_At(readerGroup, k);
                const uint16_t nbFields = SOPC_DataSetReader_Nb_FieldMetaData(dataSetReader);
                for (uint16_t l = 0; res && l < nbFields; ++l)
                {
                    const SOPC_FieldMetaData* metadata = SOPC_DataSetReader_Get_FieldMetaData_At(dataSetReader, l);
                    const SOPC_BuiltinId type = SOPC_FieldMetaData_Get_BuiltinType(metadata);
                    const int32_t valueRank = SOPC_FieldMetaData_Get_ValueRank(metadata);

                    /* Retrieve and copy the NodeId for insertion in the Cache */
                    const SOPC_FieldTarget* target = SOPC_FieldMetaData_Get_TargetVariable(metadata);
                    const SOPC_NodeId* src = SOPC_FieldTarget_Get_NodeId(target);
                    SOPC_NodeId* nid = SOPC_Calloc(1, sizeof(SOPC_NodeId));
                    res &= (NULL != nid);

                    if (res)
                    {
                        status = SOPC_NodeId_Copy(nid, src);
                        if (SOPC_STATUS_OK != status)
                        {
                            res = false;
                        }
                    }

                    /* Insert a DataValue initialized to a default value */
                    if (res)
                    {
                        SOPC_DataValue* dv = new_datavalue(type, valueRankToArrayType(valueRank));
                        res &= Cache_Set(nid, dv); /* Both will be freed by the cache */
                    }

                    if (res)
                    {
                        char* nid_str = SOPC_NodeId_ToCString(nid);
                        SOPC_Logger_TraceInfo(SOPC_LOG_MODULE_PUBSUB, "Cache: inserted %s of type %d", nid_str, type);
                        SOPC_Free(nid_str);
                    }
                    else
                    {
                        SOPC_Free(nid);
                    }
                }
            }
        }
    }

    return res;
}

SOPC_DataValue* Cache_Get(const SOPC_NodeId* nid)
{
    SOPC_ASSERT(NULL != g_cache);
    return SOPC_Dict_Get(g_cache, nid, NULL);
}

bool Cache_Set(SOPC_NodeId* nid, SOPC_DataValue* dv)
{
    SOPC_ASSERT(NULL != g_cache);
    return SOPC_Dict_Insert(g_cache, nid, dv);
}

void Cache_SetSourceVarListener(SOPC_NodeId* nid, Cache_SourceVarListener* listener)
{
    if (gListenerNid.nid != NULL)
    {
        SOPC_NodeId_Clear(gListenerNid.nid);
    }
    gListenerNid.nid = nid;
    gListenerNid.listener = listener;
}

/* nodesToRead shall be freed by the callee, and returned DataValues will be freed by the caller */
SOPC_DataValue* Cache_GetSourceVariables(OpcUa_ReadValueId* nodesToRead, int32_t nbValues)
{
    SOPC_ASSERT(NULL != nodesToRead && nbValues > 0);
    SOPC_ASSERT(INT32_MAX < SIZE_MAX || nbValues <= SIZE_MAX);

    SOPC_DataValue* dvs = SOPC_Calloc((size_t) nbValues, sizeof(SOPC_DataValue));
    if (NULL == dvs)
    {
        return dvs;
    }

    SOPC_ReturnStatus status = SOPC_STATUS_OK;
    Cache_Lock();
    for (int32_t i = 0; SOPC_STATUS_OK == status && i < nbValues; ++i)
    {
        OpcUa_ReadValueId* rv = &nodesToRead[i];
        SOPC_DataValue* dv = &dvs[i];

        /* IndexRange and DataEncoding are not supported in this cache and should be empty */
        SOPC_ASSERT(rv->IndexRange.Length <= 0 && "IndexRange not supported");
        SOPC_ASSERT(rv->DataEncoding.NamespaceIndex == 0 && rv->DataEncoding.Name.Length <= 0 &&
                    "DataEncoding not supported");

        /* As ownership is given to the caller, we have to copy all values */
        SOPC_DataValue* src = SOPC_Dict_Get(g_cache, &rv->NodeId, NULL);
        if (gListenerNid.nid != NULL)
        {
            int32_t result = -1;
            // Check listener
            SOPC_NodeId_Compare(gListenerNid.nid, &rv->NodeId, &result);
            if (result == 0)
            {
                gListenerNid.listener(src);
            }
        }
        status = SOPC_DataValue_Copy(dv, src);

        /* As we have ownership of the rv, clear it */
        OpcUa_ReadValueId_Clear(rv);
    }
    Cache_Unlock();
    SOPC_Free(nodesToRead);

    if (SOPC_STATUS_OK != status)
    {
        for (int32_t i = 0; i < nbValues; ++i)
        {
            SOPC_DataValue_Clear(&dvs[i]);
        }
        SOPC_Free(dvs);
        dvs = NULL;
    }

    return dvs;
}

/* nodesToWrite shall be freed by the callee */
bool Cache_SetTargetVariables(OpcUa_WriteValue* nodesToWrite, int32_t nbValues)
{
    SOPC_ASSERT(NULL != nodesToWrite && nbValues > 0);
    SOPC_ASSERT(INT32_MAX < SIZE_MAX || nbValues <= SIZE_MAX);

    bool ok = true;
    Cache_Lock();
    for (int32_t i = 0; ok && i < nbValues; ++i)
    {
        /* Note: the cache frees both the key and the value, so we have to give it new ones */
        OpcUa_WriteValue* wv = &nodesToWrite[i];
        SOPC_NodeId* nid = &wv->NodeId;
        SOPC_DataValue* dv = &wv->Value;

        /* IndexRange is not supported in this cache and should be empty */
        SOPC_ASSERT(wv->IndexRange.Length <= 0 && "IndexRange not supported");

        /* Divert the NodeId and the DataValue (avoid a complete copy) from the OpcUa_WriteValue and give them to our
         * dict */
        SOPC_NodeId* key = SOPC_Malloc(sizeof(SOPC_NodeId));
        SOPC_DataValue* item = SOPC_Malloc(sizeof(SOPC_DataValue));
        ok &= NULL != key && NULL != item;
        if (ok)
        {
            *key = *nid;
            SOPC_NodeId_Initialize(nid);
            *item = *dv;
            SOPC_DataValue_Initialize(dv);

            ok = Cache_Set(key, item);
        }
        else
        {
            SOPC_Free(key);
            SOPC_Free(item);
        }

        /* As we have ownership of the wv, clear it */
        OpcUa_WriteValue_Clear(wv);
    }
    Cache_Unlock();
    SOPC_Free(nodesToWrite);

    return ok;
}

void Cache_Dump_VarValue(const SOPC_NodeId* nid, const SOPC_DataValue* dv)
{
    char* nidStr = SOPC_NodeId_ToCString(nid);
    SOPC_ASSERT(NULL != nid && NULL != nidStr);

    printf("- %.25s", nidStr);

    if (NULL != dv)
    {
        static char status[22];
        if (dv->Status & SOPC_BadStatusMask)
        {
            sprintf(status, "BAD 0x%08" PRIX32, dv->Status);
        }
        else if (dv->Status & SOPC_UncertainStatusMask)
        {
            sprintf(status, "UNCERTAIN 0x%08" PRIX32, dv->Status);
        }
        else
        {
            sprintf(status, "GOOD");
        }

        char* type = "";
        switch (dv->Value.ArrayType)
        {
        case SOPC_VariantArrayType_Matrix:
            type = " ; [MAT]";
            break;
        case SOPC_VariantArrayType_Array:
            type = " ; [ARR]";
            break;
        case SOPC_VariantArrayType_SingleValue:
            break;
        }
        printf(" ; Status = %s%s", status, type);
        if (type[0] == 0)
        {
            static const char* typeName[] = {
                "Null",           "Boolean",       "SByte",         "Byte",          "Int16",           "UInt16",
                "Int32",          "UInt32",        "Int64",         "UInt64",        "Float",           "Double",
                "String",         "DateTime",      "Guid",          "ByteString",    "XmlElement",      "NodeId",
                "ExpandedNodeId", "StatusCode",    "QualifiedName", "LocalizedText", "ExtensionObject", "DataValue",
                "Variant",        "DiagnosticInfo"};

            const SOPC_BuiltinId typeId = dv->Value.BuiltInTypeId;
            if (typeId <= sizeof(typeName) / sizeof(*typeName))
            {
                printf(" ; Type=%.12s ; Val = ", typeName[typeId]);
            }
            else
            {
                printf(" ; Type=%.12s ; Val = ", "<Invalid>");
            }

            switch (typeId)
            {
            case SOPC_Boolean_Id:
                printf("%" PRId32, (int32_t) dv->Value.Value.Boolean);
                break;
            case SOPC_SByte_Id:
                printf("%" PRId32, (uint32_t) dv->Value.Value.Sbyte);
                break;
            case SOPC_Byte_Id:
                printf("%" PRId32, (int32_t) dv->Value.Value.Byte);
                break;
            case SOPC_UInt16_Id:
                printf("%" PRIu16, dv->Value.Value.Uint16);
                break;
            case SOPC_Int16_Id:
                printf("%" PRId16, dv->Value.Value.Int16);
                break;
            case SOPC_Int32_Id:
                printf("%" PRId32, dv->Value.Value.Int32);
                break;
            case SOPC_UInt32_Id:
                printf("%" PRIu32, dv->Value.Value.Uint32);
                break;
            case SOPC_Int64_Id:
                printf("%" PRId64, dv->Value.Value.Int64);
                break;
            case SOPC_UInt64_Id:
                printf("%" PRIu64, dv->Value.Value.Uint64);
                break;
            case SOPC_Float_Id:
                printf("%f", dv->Value.Value.Floatv);
                break;
            case SOPC_Double_Id:
                printf("%f", (float) dv->Value.Value.Doublev);
                break;
            case SOPC_String_Id:
                printf("<%s>", SAFE_STRING(SOPC_String_GetRawCString(&dv->Value.Value.String)));
                break;
            case SOPC_StatusCode_Id:
                printf("0x%08" PRIX32, dv->Value.Value.Status);
                break;
            default:
                printf("(...)");
                break;
            }
        }
    }
    else
    {
        printf("<no value>");
    }
    printf("\n");

    SOPC_Free(nidStr);
}

static void forEach_DoExec(const void* key, void* value, void* user_data)
{
    Cache_ForEach_Exec* exec = (Cache_ForEach_Exec*) user_data;
    exec((const SOPC_NodeId*) key, (SOPC_DataValue*) value);
}

static void Cache_ForEach_Dump(const void* key, void* value, void* user_data)
{
    (void) user_data;
    Cache_Dump_VarValue(key, value);
}

void Cache_Dump_NodeId(const SOPC_NodeId* pNid)
{
    SOPC_ASSERT(NULL != g_cache);
    Cache_Lock();
    Cache_Dump_VarValue(pNid, Cache_Get(pNid));
    Cache_Unlock();
}

void Cache_ForEach(Cache_ForEach_Exec* exec)
{
    Cache_Lock();
    SOPC_Dict_ForEach(g_cache, &forEach_DoExec, (void*) exec);
    Cache_Unlock();
}

void Cache_Dump(void)
{
    SOPC_ASSERT(NULL != g_cache);
    Cache_Lock();
    SOPC_Dict_ForEach(g_cache, &Cache_ForEach_Dump, NULL);
    Cache_Unlock();
}

void Cache_Lock(void)
{
    SOPC_ReturnStatus status = Mutex_Lock(&g_lock);
    SOPC_ASSERT(SOPC_STATUS_OK == status);
}

void Cache_Unlock(void)
{
    SOPC_ReturnStatus status = Mutex_Unlock(&g_lock);
    SOPC_ASSERT(SOPC_STATUS_OK == status);
}

void Cache_Clear(void)
{
    SOPC_Dict_Delete(g_cache);
    g_cache = NULL;
    if (gListenerNid.nid != NULL)
    {
        SOPC_NodeId_Clear(gListenerNid.nid);
        SOPC_Free(gListenerNid.nid);
        gListenerNid.nid = NULL;
        gListenerNid.listener = NULL;
    }
}
```

## src/cache.h
```c
/*
 * Licensed to Systerel under one or more contributor license
 * agreements. See the NOTICE file distributed with this work
 * for additional information regarding copyright ownership.
 * Systerel licenses this file to you under the Apache
 * License, Version 2.0 (the "License"); you may not use this
 * file except in compliance with the License. You may obtain
 * a copy of the License at
 *
 *   http://www.apache.org/licenses/LICENSE-2.0
 *
 * Unless required by applicable law or agreed to in writing,
 * software distributed under the License is distributed on an
 * "AS IS" BASIS, WITHOUT WARRANTIES OR CONDITIONS OF ANY
 * KIND, either express or implied.  See the License for the
 * specific language governing permissions and limitations
 * under the License.
 */

/** \file
 *
 * \brief Provides a cache for data values.
 *
 * This cached is based on a SOPC_Dict whose keys are SOPC_NodeId and values are SOPC_DataVariant.
 * Functions Cache_GetSourceVariables and Cache_SetTargetVariables are callback that interface PubSub with the cache.
 *
 * For now, this cache uses a single Mutex to assert that only one thread writes or read.
 * This could be enhanced with the use of a read/write double buffer for instance.
 */

#ifndef CACHE_H_
#define CACHE_H_

#include <stdbool.h>

#include "sopc_builtintypes.h"
#include "sopc_pub_source_variable.h"
#include "sopc_pubsub_conf.h"
#include "sopc_sub_target_variable.h"

/** Initializes the cache from the configuration using default zero-values (or null strings) */
bool Cache_Initialize(SOPC_PubSubConfiguration* config);

/**
 * \brief Get a value in the cache
 *
 * \warning The returned pointer is a direct access to the cached value and should not be freed
 *
 * \return A pointer to the value in cache, or NULL if not found
 */
SOPC_DataValue* Cache_Get(const SOPC_NodeId* nid);

/**
 * \brief Set a value in the cache
 *
 * \warning The ownership of given \p dv is taken by the cache, so you should not reuse or free it
 */
bool Cache_Set(SOPC_NodeId* nid, SOPC_DataValue* dv);

/** The SOPC_GetSourceVariables_Func-compatible implementation that copies the values from the cache */
SOPC_DataValue* Cache_GetSourceVariables(OpcUa_ReadValueId* nodesToRead, int32_t nbValues);

/** The SOPC_SetTargetVariables_Func-compatible implementation that copies the values to the cache */
bool Cache_SetTargetVariables(OpcUa_WriteValue* nodesToWrite, int32_t nbValues);

/** Prints on console a human-readable representation of a nid and a Datavalue

 * @param pNid The NodeId to display
 * @param dv The DataValue to display
 */
void Cache_Dump_VarValue(const SOPC_NodeId* nid, const SOPC_DataValue* dv);

/** Prints on console a human-readable representation of the whole cache
 * Note:  this call locks the cache during all operation, which will prevent
 * other tasks to respond in time.
 * This is only a debug function
 */
void Cache_Dump(void);

typedef void(Cache_ForEach_Exec)(const SOPC_NodeId* nid, SOPC_DataValue* dv);
/**
 * Execute a callback for each element of the cache.
 */
void Cache_ForEach(Cache_ForEach_Exec* exec);

/** The Cache shall be locked before accessing data (and its content, to prevent it from being freed) */
void Cache_Lock(void);
/** Unlock the cache previously locked by ::Cache_Lock */
void Cache_Unlock(void);
/** Deletes the cache */
void Cache_Clear(void);

/** Prototype for "listener" event callback. See ::Cache_SetSourceVarListener */
typedef void(Cache_SourceVarListener)(SOPC_DataValue* pDv);

/** Associates a "listener" to a given nodeId. each time the nodeId is modified
 * in the Cache, the "listener" is called.
 * @restriction In current implementation, only one listener is possible.
 * @param nid The NodeId to monitor. This nid must be allocated before call, and ownership
 *      s taken by current module (nid must be neither deallocated nor reused after call)
 * @param listener The event to call
 */
void Cache_SetSourceVarListener(SOPC_NodeId* nid, Cache_SourceVarListener* listener);

/**
 * Update a variant using a string. The string will be converted to matching type if possible
 */
bool Cache_UpdateVariant(SOPC_BuiltinId type, SOPC_VariantValue* variant, const char* value);

#endif /* CACHE_H_ */
```

## src/cache_sync.c
```c
/*
 * Licensed to Systerel under one or more contributor license
 * agreements. See the NOTICE file distributed with this work
 * for additional information regarding copyright ownership.
 * Systerel licenses this file to you under the Apache
 * License, Version 2.0 (the "License"); you may not use this
 * file except in compliance with the License. You may obtain
 * a copy of the License at
 *
 *   http://www.apache.org/licenses/LICENSE-2.0
 *
 * Unless required by applicable law or agreed to in writing,
 * software distributed under the License is distributed on an
 * "AS IS" BASIS, WITHOUT WARRANTIES OR CONDITIONS OF ANY
 * KIND, either express or implied.  See the License for the
 * specific language governing permissions and limitations
 * under the License.
 */

#include "cache_sync.h"

// System includes
#include <zephyr/kernel.h>

// S2OPC includes
#include "libs2opc_request_builder.h"
#include "libs2opc_server.h"
#include "p_time.h"
#include "sopc_assert.h"
#include "sopc_logger.h"
#include "sopc_mem_alloc.h"

// Demo includes
#include "cache.h"

#ifndef CONFIG_DEMO_CACHE_SYNCH_PERIOD_MS
#error "CONFIG_DEMO_CACHE_SYNCH_PERIOD_MS is not defined"
#endif

/***************************************************/
/**               HELPER LOG MACROS                */
/***************************************************/
#define WARNING(...) SOPC_Logger_TraceWarning(SOPC_LOG_MODULE_CLIENTSERVER, __VA_ARGS__)

/***************************************************/
/**             VARIABLES CONTENT                  */
/***************************************************/

/** A dictionary, but actually only used for Keys {NodeId* : NULL}
 * It contains the nodeId that have been received on Subscriber but not yet updated onto the server */
static SOPC_Dict* pSubscriberPendingUpdates = NULL;
K_MUTEX_DEFINE(subscriberDictgMutex);

// Thread-related data
#define SYNCH_STACK_SIZE 1024
#define SYNCH_PRIORITY (CONFIG_NUM_PREEMPT_PRIORITIES - 1)
static void synch_entry_point(void* p1, void* p2, void* p3);
K_THREAD_DEFINE(my_tid, SYNCH_STACK_SIZE, synch_entry_point, NULL, NULL, NULL, SYNCH_PRIORITY, 0, 0);

// This semaphore is used to trigger synch_entry_point task
struct k_sem my_sem;
K_SEM_DEFINE(sync_sem, 0, 1);

// Date of last reception
static int64_t gLastReceptionDateMs = 0;

typedef struct
{
    OpcUa_WriteRequest* req;
    // nodeIds is only used to monitor failing updates.
    char** nodeIds;
    size_t size;
    size_t next;
} Write_Request_Context;

/**
 * Update address space for the given NodeId*(key)
 */
static void subscriber_pushToWriteRequest(const void* key, void* value, void* user_data)
{
    (void) value;
    SOPC_ASSERT(NULL != user_data);

    Write_Request_Context* context = (Write_Request_Context*) user_data;
    OpcUa_WriteRequest* writeRequest = context->req;

    const SOPC_NodeId* pNodeId = (const SOPC_NodeId*) key;
    if (NULL != pNodeId && NULL != writeRequest)
    {
        SOPC_ReturnStatus status;
        SOPC_ASSERT(context->next < context->size);
        Cache_Lock();
        // Retrieve the value from the cache
        SOPC_DataValue* pDv = Cache_Get(pNodeId);
        status =
            SOPC_WriteRequest_SetWriteValue(writeRequest, context->next, pNodeId, SOPC_AttributeId_Value, NULL, pDv);
        SOPC_ASSERT(status == SOPC_STATUS_OK);
        Cache_Unlock();

        context->nodeIds[context->next] = SOPC_NodeId_ToCString(pNodeId);
        context->next++;
    }
}

#if CONFIG_DEMO_CACHE_SYNCH_PERIOD_MS == 0
#define CACHE_SYNCH_WAIT_NEXT_EVENT(...) \
    do                                   \
    {                                    \
    } while (0)
#define CACHE_SYNCH_INIT_NEXT_EVENT(...) \
    do                                   \
    {                                    \
    } while (0)

#else

static SOPC_RealTime* next_event = NULL;
#define CACHE_SYNCH_INIT_NEXT_EVENT() next_event = SOPC_RealTime_Create(NULL)

static inline void CACHE_SYNCH_WAIT_NEXT_EVENT(void)
{
    if (SOPC_RealTime_IsExpired(next_event, NULL))
    {
        // Immediate return and restart timer from now
        SOPC_RealTime_GetTime(next_event);
    }
    else
    {
        SOPC_RealTime_SleepUntil(next_event);
    }
    SOPC_RealTime_AddSynchedDuration(next_event, CONFIG_DEMO_CACHE_SYNCH_PERIOD_MS * 1000, 0);
}

#endif

static void synch_entry_point(void* p1, void* p2, void* p3)
{
    (void) p1;
    (void) p2;
    (void) p3;
    pSubscriberPendingUpdates = SOPC_NodeId_Dict_Create(true, NULL);
    SOPC_ASSERT(NULL != pSubscriberPendingUpdates && "SOPC_Dict_Create failed");

    CACHE_SYNCH_INIT_NEXT_EVENT();
    while (true)
    {
        CACHE_SYNCH_WAIT_NEXT_EVENT();
        // wait for event!
        k_sem_take(&sync_sem, K_FOREVER);

        // Get all pending NodeId and write them to the server @space

        SOPC_ReturnStatus status;
        OpcUa_WriteRequest* request = NULL;
        OpcUa_WriteResponse* response = NULL;
        Write_Request_Context context;
        context.nodeIds = NULL;

        // Report the values received from Subscriber to AddessSpace
        k_mutex_lock(&subscriberDictgMutex, K_FOREVER);
        const size_t nbRequests = SOPC_Dict_Size(pSubscriberPendingUpdates);

        if (nbRequests > 0)
        {
            request = SOPC_WriteRequest_Create(nbRequests);
            context.next = 0;
            context.size = nbRequests;
            context.req = request;
            context.nodeIds = SOPC_Malloc(sizeof(char*) * nbRequests);
            SOPC_ASSERT(NULL != context.nodeIds);

            // Fill OpcUa_WriteRequest
            SOPC_Dict_ForEach(pSubscriberPendingUpdates, &subscriber_pushToWriteRequest, (void*) &context);

            // Clear and recreate an empty dictionary
            SOPC_Dict_Delete(pSubscriberPendingUpdates);
            pSubscriberPendingUpdates = SOPC_NodeId_Dict_Create(true, NULL);
            SOPC_ASSERT(NULL != pSubscriberPendingUpdates && "SOPC_Dict_Create failed");
        }
        k_mutex_unlock(&subscriberDictgMutex);

        // Process to update if there are some values
        if (NULL != request)
        {
            SOPC_ASSERT(context.next == context.size);
            status = SOPC_ServerHelper_LocalServiceSync(request, (void**) &response);
            if (status != SOPC_STATUS_OK)
            {
                WARNING("SOPC_ServerHelper_LocalServiceSync failed with code  (%d)", status);
                SOPC_Free(request);
            }
        }
        if (NULL != response)
        {
            for (int32_t i = 0; i < response->NoOfResults; i++)
            {
                if (response->Results[i] != SOPC_GoodGenericStatus)
                {
                    WARNING("[SYNC]Could not update node %s, code=0x%08X", context.nodeIds[i], response->Results[i]);
                }
            }

            OpcUa_WriteResponse_Clear(response);
            SOPC_Free(response);
        }

        if (NULL != context.nodeIds)
        {
            for (int32_t i = 0; i < nbRequests; i++)
            {
                SOPC_Free(context.nodeIds[i]);
            }
            SOPC_Free(context.nodeIds);
        }
    }
}

bool cacheSync_SetTargetVariables(OpcUa_WriteValue* nodesToWrite, int32_t nbValues)
{
    gLastReceptionDateMs = k_uptime_get();
    if (pSubscriberPendingUpdates != NULL)
    {
        k_mutex_lock(&subscriberDictgMutex, K_FOREVER);
        // Memorize elements updated until next refresh
        for (size_t idx = 0; idx < nbValues; idx++)
        {
            // Memorize elements updated until next refresh
            SOPC_NodeId* copy = (SOPC_NodeId*) SOPC_Malloc(sizeof(*copy));
            SOPC_ASSERT(NULL != copy);
            SOPC_NodeId_Copy(copy, &nodesToWrite[idx].NodeId);
            SOPC_Dict_Insert(pSubscriberPendingUpdates, copy, NULL);
        }
        k_mutex_unlock(&subscriberDictgMutex);
        k_sem_give(&sync_sem);
    }
    return Cache_SetTargetVariables(nodesToWrite, nbValues);
}

void cacheSync_WriteToCache(const SOPC_NodeId* pNid, const SOPC_DataValue* pDv)
{
    Cache_Lock();
    SOPC_DataValue* pDvCache = Cache_Get(pNid);

    // Only write values of cache that are already defined
    if (pDvCache != NULL)
    {
        // Replace content of Cache
        SOPC_DataValue_Clear(pDvCache);
        SOPC_DataValue_Copy(pDvCache, pDv);
    }
    Cache_Unlock();
}

int cacheSync_LastReceptionDateMs(void)
{
    const int64_t now = k_uptime_get();
    return now - gLastReceptionDateMs;
}
```

## src/cache_sync.h
```c
/*
 * Licensed to Systerel under one or more contributor license
 * agreements. See the NOTICE file distributed with this work
 * for additional information regarding copyright ownership.
 * Systerel licenses this file to you under the Apache
 * License, Version 2.0 (the "License"); you may not use this
 * file except in compliance with the License. You may obtain
 * a copy of the License at
 *
 *   http://www.apache.org/licenses/LICENSE-2.0
 *
 * Unless required by applicable law or agreed to in writing,
 * software distributed under the License is distributed on an
 * "AS IS" BASIS, WITHOUT WARRANTIES OR CONDITIONS OF ANY
 * KIND, either express or implied.  See the License for the
 * specific language governing permissions and limitations
 * under the License.
 */

/** \file
 *
 * \brief Provides a synchronization mechanism between cache and AddressSpace
 * There are different ways to provide this mechanism, and they can be
 * switched using the CONFIG_CACHE_SYNCH or CONFIG_CACHE_ASYNCH parameter
 */

#ifndef CACHE_SYNCH_H_
#define CACHE_SYNCH_H_

#include <stdbool.h>

// S2OPC includes
#include "sopc_builtintypes.h"
#include "sopc_types.h"

#define ASYNCH_CONTEXT_CACHE_SYNC 0xCAC3E51Cu

/**
 * @brief Event called when the subscriber receives new values
 * @param nodesToWrite An array of write events
 * @param nbValues The number of elements in nodesToWrite
 */
bool cacheSync_SetTargetVariables(OpcUa_WriteValue* nodesToWrite, int32_t nbValues);

/**
 * @brief Provide a new value to store in the PubSubCache
 * This function should be called each time the Server AddressSpace is modified

 * @param pNid The modified NodeId in AddressSpace
 * @param pDv The new value
 */
void cacheSync_WriteToCache(const SOPC_NodeId* pNid, const SOPC_DataValue* pDv);

/**
 * Return the number of milliseconds since last call to cacheSync_SetTargetVariables
 */
int cacheSync_LastReceptionDateMs(void);

#endif // CACHE_SYNCH_H_
```
