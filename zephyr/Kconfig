## zephyr/Kconfig
```kconfig
# S2OPC OPC UA Library

# Copyright (c) 2016 Intel Corporation
# SPDX-License-Identifier: Apache-2.0

menuconfig S2OPC
	bool "S2OPC Support"
	help
	  This option enables the S2OPC library.

config SOPC_HAS_SERVER
	bool "S2OPC implements an OPC server"
	default y
	depends on S2OPC
	help
	  This value is used by Server and Client sample
	  
config SOPC_ETH_ADDRESS
	string "Eth address"
	default "192.168.10.22"
	depends on S2OPC
	help
	  This value is used by Server and Client sample
	  
config SOPC_ENDPOINT_ADDRESS
	string "Eth address"
	default "opc.tcp://192.168.10.22:4841"
	depends on S2OPC
	help
	  This value is used by Server and Client sample
	  
config SOPC_ETH_GW
	string "Gateway for ETH network"
	default "192.168.10.2"
	depends on S2OPC
	help
	  This value is used by Server sample

config SOPC_ETH_NETMASK
	string "Netmask for ETH network"
	default "255.255.255.0"
	depends on S2OPC
	help
	  This value is used by Server sample

config SOPC_PUBLISHER_ADDRESS
	string "Publisher address"
	default "opc.udp://232.1.2.100:4840"
	depends on S2OPC
	help
	  This value is used by Publisher

config SOPC_SUBSCRIBER_ADDRESS
	string "Subscriber address"
	default "opc.udp://232.1.2.101:4840"
	depends on S2OPC
	help
	  This value is used by Subscriber
	  
config SOPC_SUBSCRIBER_PERIOD_US
	int "Subscriber period in microseconds"
	default 10000
	depends on S2OPC
	help
	  This value is used by Subscriber

config SOPC_PUBLISHER_PERIOD_US
	int "Publisher period in microseconds"
	default 10000
	depends on S2OPC
	help
	  This value is used by Publisher

config SOPC_PUBSUB_USES_CACHE
	bool "S2OPC pubsub uses cache (true) or address space (false)"
	default y
	depends on S2OPC
	help
	  This value is used by Server and Client sample
	  
config SOPC_USER_STACK_SIZE
	int "Stack size of applicative (in Kb) user tasks if called by P_THREAD_Create or P_THREAD_CreatePrioritized"
	default 4
	depends on S2OPC
	help
	  Stack size of applicative (in Kb) user tasks if called by P_THREAD_Create or P_THREAD_CreatePrioritized

config SOPC_MAX_USER_TASKS
	int "Maximum number of users threads that can be created by S2OPC"
	default 1
	depends on S2OPC
	help
	  Maximum number of users threads that can be created by S2OPC

config SOPC_PUBLISHER_PRIORITY
	int "Publisher threads priority"
	default 8
	depends on S2OPC
	help
	  To ensure SOPC compatibility, an offset of CONFIG_NUM_COOP_PRIORITIES must be included. 
	  E.g CONFIG_SOPC_PUBLISHER_PRIORITY = 0 => actual priority = -CONFIG_NUM_COOP_PRIORITIES

config SOPC_SUBSCRIBER_PRIORITY
	int "Subscriber threads priority"
	default 10
	depends on S2OPC
	help
	  To ensure SOPC compatibility, an offset of CONFIG_NUM_COOP_PRIORITIES must be included. 
	  E.g SOPC_SUBSCRIBER_PRIORITY = 0 => actual priority = -CONFIG_NUM_COOP_PRIORITIES

config SOPC_THREAD_DEFAULT_PRIORITY
	int "Default thread priority for SOPC threads"
	default 27
	depends on S2OPC
	help
	  Default thread priority for SOPC threads (Call to SOPC_Thread_Create)
	  To ensure SOPC compatibility, an offset of CONFIG_NUM_COOP_PRIORITIES must be included. 
	  E.g SOPC_THREAD_DEFAULT_PRIORITY = CONFIG_NUM_COOP_PRIORITIES + 5 => actual priority = 5
	
config SOPC_UTILITY_TASK_STACK_SIZE
	int  "Stack size for Application and Timers S2OPC tasks"
	default 1
	depends on S2OPC
	help
	  Stack size (Kb) for "Application" & "Timers" S2OPC tasks
	
config SOPC_MAIN_TASK_STACK_SIZE
	int  "Stack size for SubSocketMgr, Publisher and Sockets S2OPC tasks"
	default 2
	depends on S2OPC
	help
	  Stack size (Kb) for "SubSocketMgr", "Publisher" & "Sockets" S2OPC tasks

config SOPC_LARGE_TASK_STACK_SIZE
	int  "Stack size for Secure_Chann, Publisher and Services S2OPC tasks"
	default 4
	depends on S2OPC
	help
	  Stack size (Kb) for "Secure_Chann" & "Services" S2OPC tasks

config SOPC_HELPER_IMPL_INSTRUM
	bool "Debug S2OPC ZEPHYR implementation"
	default 0
	depends on S2OPC
	help
	  Set to 1 to allow debug and instrumentations of threading implementation
	
config SOPC_PTP_SYNCH_DURATION
	int  "Duration (s) of one clock synchronization step while PtP SLAVE"
	default 5
	depends on S2OPC
	help
	  Duration (ms) of one clock synchronization step while PtP SLAVE
	  This synchronisation starts when remote clock versus local clock
	  have quite continuous offset.
		
```
