## CMakeLists.txt
```
cmake_minimum_required(VERSION 3.20.0)

set(S2OPC_SAMPLE_ZEPHYR ON)

if(DEFINED BOARD AND NOT "${BOARD}" STREQUAL "")
  set(BOARD_CFG "${BOARD}")
elseif(DEFINED ENV{BOARD} AND NOT "$ENV{BOARD}" STREQUAL "")
  set(BOARD_CFG "$ENV{BOARD}")
  set(BOARD "${BOARD_CFG}" CACHE STRING "Zephyr board" FORCE)
else()
  message(FATAL_ERROR "BOARD must be provided (for example: west build -b <board>)")
endif()

set(CONF_FILE_CRYPTO "prj.conf")
if(DEFINED ENV{NOCRYTO} AND NOT "$ENV{NOCRYTO}" STREQUAL "")
  set(CONF_FILE_CRYPTO "prj-nocrypto.conf")
  set(S2OPC_CRYPTO_LIB "nocrypto")
else()
  add_compile_definitions(S2OPC_CRYPTO_MBEDTLS=1)
endif()

set(CONF_FILE "${CMAKE_CURRENT_LIST_DIR}/${CONF_FILE_CRYPTO}")
if(EXISTS "${CMAKE_CURRENT_LIST_DIR}/boards/${BOARD_CFG}.conf")
  list(APPEND CONF_FILE "${CMAKE_CURRENT_LIST_DIR}/boards/${BOARD_CFG}.conf")
endif()

if(EXISTS "${CMAKE_CURRENT_LIST_DIR}/boards/${BOARD_CFG}.overlay")
  set(DTC_OVERLAY_FILE "${CMAKE_CURRENT_LIST_DIR}/boards/${BOARD_CFG}.overlay")
endif()

set(S2OPC_ROOT_PATH ${SAMPLE_SRC_DIR}/../../..)

get_filename_component(S2OPC_ROOT_PATH "${S2OPC_ROOT_PATH}" ABSOLUTE)

list(APPEND EXTRA_ZEPHYR_MODULES "${S2OPC_ROOT_PATH}")
list(REMOVE_DUPLICATES EXTRA_ZEPHYR_MODULES)

find_package(Zephyr 4.3.0 REQUIRED HINTS $ENV{ZEPHYR_BASE})

project(${SAMPLE_PROJECT_NAME})

if(NOT CONFIG_S2OPC)
  message(FATAL_ERROR "CONFIG_S2OPC is expected to be set in ${CONF_FILE}")
endif()

# App-level configuration used by the Zephyr sample sources.
add_compile_definitions(
  WITH_STATIC_SECURITY_DATA=1
  WITH_USER_ASSERT=1
  SOPC_HAS_FILESYSTEM=0
)
add_compile_options(-UNDEBUG -Werror)

# =====================
# S2OPC BUILD VARIABLES
# =====================
execute_process(COMMAND git rev-parse HEAD OUTPUT_VARIABLE BUILD_SRC_COMMIT)
string(REGEX REPLACE "\n$" "" BUILD_SRC_COMMIT "${BUILD_SRC_COMMIT}")
if("${BUILD_SRC_COMMIT}" STREQUAL "")
  set(BUILD_SRC_COMMIT "UNDEFINED")
endif()

add_compile_definitions(
  BUILD_SRC_COMMIT="${BUILD_SRC_COMMIT}"
  BUILD_DOCKER_ID="N.A."
  BUILD_BUILD_DATE=__DATE__" "__TIME__
)

set(mbedtls_config ${CMAKE_CURRENT_LIST_DIR}/../mbedtls_config)

set(common_include_dirs
  ${mbedtls_config}
  ${CMAKE_CURRENT_LIST_DIR}/../include
  ${CMAKE_CURRENT_LIST_DIR}/src
  ${CMAKE_CURRENT_SOURCE_DIR}/src
  ${S2OPC_ROOT_PATH}/samples/ClientServer/data/cert
)

zephyr_include_directories(${common_include_dirs})

file(GLOB app_sources
  ${CMAKE_CURRENT_LIST_DIR}/src/*.c
  ${CMAKE_CURRENT_SOURCE_DIR}/src/*.c
)

if("${CONFIG_SOPC_CRYPTO_LIB_NAME}" STREQUAL "mbedtls")
  if(EXISTS "${ZEPHYR_BASE}/../modules/mbedtls/configs/config-mbedtls.h")
    set(ZEPHYR_MBEDTLS_CONFIG_DIR "${ZEPHYR_BASE}/../modules/mbedtls/configs")
  elseif(EXISTS "${ZEPHYR_BASE}/modules/mbedtls/configs/config-mbedtls.h")
    set(ZEPHYR_MBEDTLS_CONFIG_DIR "${ZEPHYR_BASE}/modules/mbedtls/configs")
  elseif(EXISTS "${ZEPHYR_BASE}/../modules/crypto/mbedtls/configs/config-mbedtls.h")
    set(ZEPHYR_MBEDTLS_CONFIG_DIR "${ZEPHYR_BASE}/../modules/crypto/mbedtls/configs")
  else()
    message(FATAL_ERROR "config-mbedtls.h introuvable")
  endif()

  zephyr_include_directories(${ZEPHYR_MBEDTLS_CONFIG_DIR})

  if(EXISTS "${ZEPHYR_BASE}/../modules/mbedtls/include")
    zephyr_include_directories("${ZEPHYR_BASE}/../modules/mbedtls/include")
  endif()

  if(EXISTS "${ZEPHYR_BASE}/../modules/crypto/mbedtls/include")
    zephyr_include_directories("${ZEPHYR_BASE}/../modules/crypto/mbedtls/include")
  endif()

  file(GLOB mbedtls_sources
    ${mbedtls_config}/*.c
  )
  list(APPEND app_sources ${mbedtls_sources})
endif()

target_sources(app PRIVATE ${app_sources})
```

## prj.conf
```kconfig
#######################
# CONFIGURATION FOR ZEPHYR PUBSUB SERVER demo
#######################
# Important Note:
# This file holds the board-unrelated configuration.
# For specificities, see file board/$boardname.conf (Automatically parsed by ZEPHYR)


# CONFIG_DEBUG_THREAD_INFO=y
# CONFIG_LOG_IMMEDIATE=y
# CONFIG_NET_LOG=y
# CONFIG_ETHERNET_LOG_LEVEL_DBG=y

#######################
# General config
CONFIG_NEWLIB_LIBC=y
CONFIG_HEAP_MEM_POOL_SIZE=65536
CONFIG_MAIN_STACK_SIZE=6144
CONFIG_SHELL_STACK_SIZE=3072

CONFIG_SOCKS=y
CONFIG_ZVFS_OPEN_MAX=16
CONFIG_INIT_STACKS=n

#####################
# Networking config

CONFIG_NETWORKING=y               # Required for networking
CONFIG_NET_INTERFACE_NAME=n
CONFIG_NET_IPV4=y                 # enables IPV4
CONFIG_NET_IPV4_AUTO=n            # enables ARP automatic answers
CONFIG_NET_TCP=y                  # enables tcp stack
CONFIG_NET_SOCKETS=y              # enables sockets
CONFIG_ZVFS_POLL_MAX=5

CONFIG_NET_L2_DUMMY=y             # enables LOOPBACK card
CONFIG_NET_L2_ETHERNET=y          # enables ETHERNET card
CONFIG_NET_LOOPBACK=y             # enables LOOPBACK card
CONFIG_NET_ARP=y                  # enables ARP
CONFIG_NET_MGMT=y
CONFIG_DNS_RESOLVER=y

CONFIG_NET_DEFAULT_IF_ETHERNET=y
CONFIG_NET_MAX_CONN=16
CONFIG_NET_MAX_CONTEXTS=16
CONFIG_NET_TX_STACK_SIZE=1500

CONFIG_NET_IF_MAX_IPV4_COUNT=2
CONFIG_NET_IF_MCAST_IPV4_ADDR_COUNT=8
CONFIG_NET_BUF_DATA_SIZE=2048

CONFIG_NET_DRIVERS=y              # Required for communications
CONFIG_NET_CONFIG_SETTINGS=y
CONFIG_NET_CONFIG_NEED_IPV4=y
CONFIG_NET_CONFIG_INIT_TIMEOUT=30
CONFIG_NET_SOCKETS_CONNECT_TIMEOUT=10000
CONFIG_NET_NATIVE=y               # uses zephyr net stack
# > 2 connections => 5, For 3 cnx => 8
CONFIG_ZVFS_POLL_MAX=8

# CONFIG_NET_CONFIG_MY_IPV6_ADDR="2001:db8:100::1"
# CONFIG_NET_CONFIG_PEER_IPV6_ADDR="2001:db8:100::2"

# Default IP on LOOPBACK
CONFIG_NET_CONFIG_MY_IPV4_ADDR="192.0.2.10"

# Default MASK on LOOPBACK
CONFIG_NET_CONFIG_MY_IPV4_NETMASK="255.255.255.0"

# Default GW on LOOPBACK
CONFIG_NET_CONFIG_MY_IPV4_GW="192.0.2.2"

CONFIG_SOPC_ETH_ADDRESS="192.168.42.21"
CONFIG_SOPC_ETH_GW="192.168.42.2"
# Number of IP on each card
CONFIG_NET_IF_UNICAST_IPV4_ADDR_COUNT=3

# Each CONFIG_NET_PKT_xX_COUNT costs 44 bytes
CONFIG_NET_PKT_RX_COUNT=12
CONFIG_NET_PKT_TX_COUNT=18
# Each CONFIG_NET_BUF_xX_COUNT costs 200 bytes (default = 36)
CONFIG_NET_BUF_RX_COUNT=18
CONFIG_NET_BUF_TX_COUNT=24


#####################
# MbedTLS
CONFIG_SOPC_CRYPTO_LIB_NAME="mbedtls"
CONFIG_MBEDTLS=y
CONFIG_MBEDTLS_BUILTIN=y
CONFIG_MBEDTLS_SSL_PROTO_DTLS=n
# Use the Zephyr-generated config-mbedtls.h, then append the
# S2OPC-specific PK/X509/threading additions through the user config hook.
# CONFIG_MBEDTLS_GENPRIME_ENABLED is not set
CONFIG_MBEDTLS_HMAC_DRBG_C=y
CONFIG_MBEDTLS_ENTROPY_C=y

CONFIG_MBEDTLS_SHA1=y
CONFIG_MBEDTLS_ENABLE_HEAP=n

CONFIG_MBEDTLS_KEY_EXCHANGE_PSK_ENABLED=y
# CONFIG_MBEDTLS_KEY_EXCHANGE_RSA_PSK_ENABLED is not set
CONFIG_MBEDTLS_PEM_CERTIFICATE_FORMAT=y
CONFIG_MBEDTLS_SSL_MAX_CONTENT_LEN=2048
CONFIG_MBEDTLS_CIPHER_AES_ENABLED=y
CONFIG_MBEDTLS_CIPHER_MODE_CBC_ENABLED=y
CONFIG_MBEDTLS_CFG_FILE="config-mbedtls.h"

CONFIG_MBEDTLS_USER_CONFIG_ENABLE=y
CONFIG_MBEDTLS_USER_CONFIG_FILE="config_custom_mbedtls.h"

# CONFIG_MBEDTLS_MEMORY_DEBUG=y

CONFIG_MBEDTLS_ENTROPY_POLL_ZEPHYR=y

CONFIG_ENTROPY_GENERATOR=y
CONFIG_TEST_RANDOM_GENERATOR=y

#####################
# S2OPC
# Activates S2OPC module
CONFIG_S2OPC=y
CONFIG_SOPC_PUBLISHER_PERIOD_US=1000000
CONFIG_SOPC_SUBSCRIBER_PERIOD_US=1000000

CONFIG_SOPC_PUBLISHER_ADDRESS="opc.udp://232.1.2.100:4840"
CONFIG_SOPC_SUBSCRIBER_ADDRESS="opc.udp://232.1.2.101:4840"

#####################
# Demo-specific

#####################
# for debug:
CONFIG_SOPC_ENDPOINT_ADDRESS="opc.tcp://192.168.42.21:4841"

# To debug and instrument MEM ALLOC
CONFIG_SYS_HEAP_RUNTIME_STATS=y

# To monitor memory and stacks:
CONFIG_INIT_STACKS=y
CONFIG_THREAD_STACK_INFO=y
CONFIG_THREAD_MONITOR=y
CONFIG_THREAD_RUNTIME_STATS=y
CONFIG_SCHED_THREAD_USAGE_ANALYSIS=y

# CONFIG_LOG=y
# CONFIG_DEBUG_COREDUMP=y
# CONFIG_FAULT_DUMP=2
# CONFIG_DEBUG_COREDUMP_BACKEND_LOGGING=y
# CONFIG_DEBUG_COREDUMP_MEMORY_DUMP_MIN=y

# provides a console with net tools (after application returns)
CONFIG_SHELL=y
CONFIG_NET_SHELL=y

# required for CONFIG_CONSOLE_GETLINE
# CONFIG_CONSOLE_SUBSYS=y

# provides "getline" feature to application
# CONFIG_CONSOLE_GETLINE=y
CONFIG_REBOOT=y
```

## prj-nocrypto.conf
```kconfig
#######################
# CONFIGURATION FOR ZEPHYR PUBSUB SERVER demo
#######################
# Important Note:
# This file holds the board-unrelated configuration.
# For specificities, see file board/$boardname.conf (Automatically parsed by ZEPHYR)


#######################
# General config
CONFIG_NEWLIB_LIBC=y
CONFIG_HEAP_MEM_POOL_SIZE=65536
CONFIG_MAIN_STACK_SIZE=6144
CONFIG_SHELL_STACK_SIZE=3072

CONFIG_SOCKS=y
CONFIG_ZVFS_OPEN_MAX=16
CONFIG_INIT_STACKS=n

#####################
# Networking config

CONFIG_NETWORKING=y   				# Required for networking
CONFIG_NET_INTERFACE_NAME=n
CONFIG_NET_IPV4=y					# enables IPV4
CONFIG_NET_IPV4_AUTO=n				# enables ARP automatic answers
CONFIG_NET_TCP=y					# enables tcp stack
CONFIG_NET_SOCKETS=y				# enables sockets
CONFIG_ZVFS_POLL_MAX=5

CONFIG_NET_L2_DUMMY=y				# enables LOOPBACK card
CONFIG_NET_L2_ETHERNET=y			# enables ETHERNET card
CONFIG_NET_LOOPBACK=y				# enables LOOPBACK card
CONFIG_NET_ARP=y					# enables ARP
CONFIG_NET_MGMT=y
CONFIG_DNS_RESOLVER=y

CONFIG_NET_ARP_GRATUITOUS=y
CONFIG_NET_ARP_GRATUITOUS_INTERVAL=15
CONFIG_NET_ARP_GRATUITOUS_TRANSMISSION=y

CONFIG_NET_DEFAULT_IF_ETHERNET=y	# 
CONFIG_NET_MAX_CONN=16
CONFIG_NET_MAX_CONTEXTS=16
CONFIG_NET_TX_STACK_SIZE=1500

CONFIG_NET_IF_MAX_IPV4_COUNT=2
CONFIG_NET_IF_MCAST_IPV4_ADDR_COUNT=8
CONFIG_NET_BUF_DATA_SIZE=2048

CONFIG_NET_DRIVERS=y				# Required for communications
CONFIG_NET_CONFIG_SETTINGS=y
CONFIG_NET_CONFIG_NEED_IPV4=y
CONFIG_NET_CONFIG_INIT_TIMEOUT=3
CONFIG_NET_NATIVE=y					# uses zephyr net stack
#> 2 connections => 5, For 3 cnx => 8 
CONFIG_ZVFS_POLL_MAX=8

# CONFIG_NET_CONFIG_MY_IPV6_ADDR="2001:db8:100::1"
# CONFIG_NET_CONFIG_PEER_IPV6_ADDR="2001:db8:100::2"

# Default IP on LOOPBACK
CONFIG_NET_CONFIG_MY_IPV4_ADDR="192.0.2.10"

# Default MASK on LOOPBACK
CONFIG_NET_CONFIG_MY_IPV4_NETMASK="255.255.255.0"

# Default GW on LOOPBACK
CONFIG_NET_CONFIG_MY_IPV4_GW="192.0.2.2"

CONFIG_SOPC_ETH_ADDRESS="192.168.42.21"
CONFIG_SOPC_ETH_GW="192.168.42.2"
# Number of IP on each card
CONFIG_NET_IF_UNICAST_IPV4_ADDR_COUNT=3

# Each CONFIG_NET_PKT_xX_COUNT costs 44 bytes
CONFIG_NET_PKT_RX_COUNT=12
CONFIG_NET_PKT_TX_COUNT=18
# Each CONFIG_NET_BUF_xX_COUNT costs 200 bytes (defaut = 36)
CONFIG_NET_BUF_RX_COUNT=18
CONFIG_NET_BUF_TX_COUNT=24

CONFIG_SOPC_CRYPTO_LIB_NAME="nocrypto"
CONFIG_MBEDTLS=n

CONFIG_ENTROPY_GENERATOR=y
CONFIG_TEST_RANDOM_GENERATOR=y
#####################
# S2OPC
# Activates S2OPC module
CONFIG_S2OPC=y
CONFIG_SOPC_PUBLISHER_PERIOD_US=1000000
CONFIG_SOPC_SUBSCRIBER_PERIOD_US=1000000

CONFIG_SOPC_PUBLISHER_ADDRESS="opc.udp://232.1.2.100:4840"
CONFIG_SOPC_SUBSCRIBER_ADDRESS="opc.udp://232.1.2.101:4840"

#####################
# Demo-specific

#####################
# for debug:
CONFIG_SOPC_ENDPOINT_ADDRESS="opc.tcp://192.168.42.21:4841"

# To debug and instrument MEM ALLOC
CONFIG_SYS_HEAP_RUNTIME_STATS=y

# CONFIG_LOG=y
# CONFIG_DEBUG_COREDUMP=y
# CONFIG_FAULT_DUMP=2
# CONFIG_DEBUG_COREDUMP_BACKEND_LOGGING=y
# CONFIG_DEBUG_COREDUMP_MEMORY_DUMP_MIN=y

# provides a console with net tools (after application returns)	
CONFIG_SHELL=y
CONFIG_NET_SHELL=y

# required for CONFIG_CONSOLE_GETLINE
#CONFIG_CONSOLE_SUBSYS=y

# provides "getline" feature to application
#CONFIG_CONSOLE_GETLINE=y
CONFIG_REBOOT=y
```

## boards/mimxrt1064_evk.conf
```kconfig
# MIMX1064-evk-specific configuration

#####################
# ENTROPY
# Depends on target hability to provide entropy...
CONFIG_ENTROPY_GENERATOR=y
CONFIG_TEST_RANDOM_GENERATOR=y
#CONFIG_SOC_SERIES_IMX_RT=y
#CONFIG_SOC_SERIES_IMX_RT10XX=y

# IMX network won't receive MC UDP packet if CONFIG_ETH_MCUX_PROMISCUOUS_MODE is not set
# There may be a more clean solution, but it still has to be defined...
CONFIG_ETH_DRIVER=y
# MCUX driver are deprecated
#CONFIG_ETH_MCUX=y
#CONFIG_ETH_MCUX_PROMISCUOUS_MODE=y 
```

## boards/native_posix_64.conf
```kconfig
# This board is not functional with S2OPC under Zephyr version 3.6.0.
# See issue #1507 on https://gitlab.com/systerel/S2OPC/-/issues/1507
```

## boards/native_sim.conf
```kconfig
#Doesnt compile as of v4.1.0
CONFIG_PICOLIBC=y
```

## boards/nucleo_h723zg.conf
```kconfig
# STM32H747-specific configuration

#Does not work with MBTLS from lack of memory
CONFIG_ETH_STM32_HAL=y
CONFIG_HEAP_MEM_POOL_SIZE=55000
```

## boards/nucleo_h745zi_q_m7.conf
```kconfig
# STM32H747-specific configuration

CONFIG_ETH_STM32_HAL=y
CONFIG_SOPC_ALLOC_SECTION=".dtcm_data"
```

## boards/nucleo_h563zi.overlay
```dts
/* STM32H563-specific overlay to the standard DeviceTree
 *
 * SRAM1, SRAM2 and SRAM3 are contiguous so they are clustered
 * together to take advantage of the space they have to offer.
 */

/delete-node/ &sram1;
/delete-node/ &sram2;
/delete-node/ &sram3;


/ {
    chosen {
        zephyr,sram = &sram123;
    };

    sram123: memory@20000000 {
        compatible = "mmio-sram";
        //compatible = "zephyr,memory-region", "mmio-sram";
        reg = <0x20000000 DT_SIZE_K(576)>;
        //zephyr,memory-region = "SRAM123";
    };

    sram3_res_ecc: memory@20090000 {
        compatible = "zephyr,memory-region", "mmio-sram";
        reg = <0x20090000 DT_SIZE_K(64)>;
        zephyr,memory-region = "SRAM3_RES_ECC";
    };
};
```

## boards/stm32h573i_dk.overlay
```dts
/* STM32H573-specific overlay to the standard DeviceTree
 *
 * SRAM1, SRAM2 and SRAM3 are contiguous so they are clustered
 * together to take advantage of the space they have to offer.
 */

/delete-node/ &sram1;
/delete-node/ &sram2;
/delete-node/ &sram3;


/ {
    chosen {
        zephyr,sram = &sram123;
    };

    sram123: memory@20000000 {
        compatible = "mmio-sram";
        //compatible = "zephyr,memory-region", "mmio-sram";
        reg = <0x20000000 DT_SIZE_K(576)>;
        //zephyr,memory-region = "SRAM123";
    };

    sram3_res_ecc: memory@20090000 {
        compatible = "zephyr,memory-region", "mmio-sram";
        reg = <0x20090000 DT_SIZE_K(64)>;
        zephyr,memory-region = "SRAM3_RES_ECC";
    };
};
```

## src/zephyr_network_init.c
```c
/*
 * Licensed to Systerel under one or more contributor license
 * agreements. See the NOTICE file distributed with this work
 * for additional information regarding copyright ownership.
 * Systerel licenses this file to you under the Apache
 * License, Version 2.0 (the "License"); you may not use this
 * file except in compliance with the License. You may obtain
 * a copy of the License at
 *
 *   http://www.apache.org/licenses/LICENSE-2.0
 *
 * Unless required by applicable law or agreed to in writing,
 * software distributed under the License is distributed on an
 * "AS IS" BASIS, WITHOUT WARRANTIES OR CONDITIONS OF ANY
 * KIND, either express or implied.  See the License for the
 * specific language governing permissions and limitations
 * under the License.
 */

#include <errno.h>
#include <inttypes.h>
#include <limits.h>
#include <zephyr/kernel.h>

#include <stdbool.h>
#include <stdint.h>
#include <stdio.h>
#include <stdlib.h>

#include <fcntl.h>
#include <zephyr/kernel.h>
#include <zephyr/net/ethernet.h>
#include <zephyr/net/net_if.h>
#include <zephyr/net/net_ip.h>
#include <zephyr/net/socket.h>

#include "sopc_assert.h"
#include "sopc_mutexes.h"
#include "zephyr_network_init.h"

#define MY_IP_LB ((const char*) ("127.0.0.1"))
#define MY_IP_LB_MASK ((const char*) ("255.255.255.0"))
#define MY_IP_LB_GW ((const char*) ("127.0.0.1"))

#ifndef CONFIG_SOPC_ETH_ADDRESS
#error "CONFIG_SOPC_ETH_ADDRESS is not defined!"
#endif

#ifndef CONFIG_SOPC_ETH_GW
#error "CONFIG_SOPC_ETH_GW is not defined!"
#endif

#ifndef CONFIG_SOPC_ETH_NETMASK
#error "CONFIG_SOPC_ETH_NETMASK is not defined!"
#endif

#ifndef CONFIG_NET_L2_DUMMY
#error 'CONFIG_NET_L2_DUMMY is required for this demo'
#endif

#ifndef CONFIG_NET_L2_ETHERNET
#error 'CONFIG_NET_L2_ETHERNET is required for this demo'
#endif

/* Max socket based on max connections allowed by zephyr */

#ifdef CONFIG_NET_MAX_CONN
#define MAX_ZEPHYR_SOCKET (CONFIG_NET_MAX_CONN - 2)
#else
#define MAX_ZEPHYR_SOCKET 4
#endif

typedef struct NetItf
{
    const char* name;
    const struct net_l2* l2;
} NetItf;

static const NetItf netl2Loopback = {.name = "DUMMY", .l2 = &NET_L2_GET_NAME(DUMMY)};
static const NetItf netl2ethernet = {.name = "ETHERNET", .l2 = &NET_L2_GET_NAME(ETHERNET)};

static volatile bool priv_P_SOCKET_networkConfigStatus = false;

// *** Weak p_sockets functions definitions ***

static bool configure_interface(const NetItf* itf, const char* ipAddr, const char* netmask, const char* gwIp)
{
    struct in_addr address;
    struct in_addr addressMask;
    struct in_addr addressGtw;
    struct net_if* ptrNetIf = NULL;
    struct net_if_addr* newInterface;

    net_addr_pton(AF_INET, ipAddr, (void*) &address);
    net_addr_pton(AF_INET, netmask, (void*) &addressMask);
    net_addr_pton(AF_INET, gwIp, (void*) &addressGtw);
    printk("Configure %s with %s , Mask = %s, GW= %s\r\n", itf->name, ipAddr, netmask, gwIp);

    if (NULL == net_if_ipv4_addr_lookup(&address, &ptrNetIf))
    {
        ptrNetIf = net_if_get_first_by_type(itf->l2);
        if (ptrNetIf != NULL)
        {
            SOPC_ASSERT(NULL != ptrNetIf->if_dev->dev->name);
            printk("Using interface (%s)\n", ptrNetIf->if_dev->dev->name);
        }
        else
        {
            printk("Could not find matching network interface!\n");
            return false;
        }
        newInterface = net_if_ipv4_addr_add(ptrNetIf, &address, NET_ADDR_MANUAL, 0);
        if (NULL == newInterface)
        {
            printk("Could not add IP to network interface %s!\n", itf->name);
            return false;
        }
        printk("Added IP = <%s> to <%s> !\n", ipAddr, ptrNetIf->if_dev->dev->name);
        if (!net_if_ipv4_set_netmask_by_addr(ptrNetIf, &address, &addressMask))
        {
            printk("Could not set netmask to network interface %s!\n", itf->name);
            return false;
        }
        net_if_ipv4_set_gw(ptrNetIf, &addressGtw);
    }
    return true;
}

bool Network_Initialize(const char* overrideEthAddr)
{
    if (!priv_P_SOCKET_networkConfigStatus)
    {
        if (!configure_interface(&netl2Loopback, MY_IP_LB, MY_IP_LB_MASK, MY_IP_LB_GW))
        {
            printk("Initialization of LOOPBACK failed\n");
            return false;
        }
        const char* ethAddr = (overrideEthAddr ? overrideEthAddr : CONFIG_SOPC_ETH_ADDRESS);
        if (!configure_interface(&netl2ethernet, ethAddr, CONFIG_SOPC_ETH_NETMASK, CONFIG_SOPC_ETH_GW))
        {
            printk("Initialization of ETH failed\n");
            return false;
        }

        printk("Waiting for the network to be up\n");
        while (net_if_get_first_by_type(&NET_L2_GET_NAME(ETHERNET)) == NULL)
        {
            k_sleep(K_MSEC(100));
        }

        priv_P_SOCKET_networkConfigStatus = true;
    }
    return priv_P_SOCKET_networkConfigStatus;
}
```

## src/zephyr_network_init.h
```c
/*
 * Licensed to Systerel under one or more contributor license
 * agreements. See the NOTICE file distributed with this work
 * for additional information regarding copyright ownership.
 * Systerel licenses this file to you under the Apache
 * License, Version 2.0 (the "License"); you may not use this
 * file except in compliance with the License. You may obtain
 * a copy of the License at
 *
 *   http://www.apache.org/licenses/LICENSE-2.0
 *
 * Unless required by applicable law or agreed to in writing,
 * software distributed under the License is distributed on an
 * "AS IS" BASIS, WITHOUT WARRANTIES OR CONDITIONS OF ANY
 * KIND, either express or implied.  See the License for the
 * specific language governing permissions and limitations
 * under the License.
 */

#ifndef ZEPHYR_NETWORK_INIT_H_
#define ZEPHYR_NETWORK_INIT_H_

#include <stdbool.h>

/** \brief
 * Configure the network for ZEPHYR with LOOPBACK and ETH0
 * \param overrideEthAddr Ip address to set-up eth0 card.
 *  \a CONFIG_SOPC_ETH_ADDRESS is used if NULL.
 */
bool Network_Initialize(const char* overrideEthAddr);

#endif /* ZEPHYR_NETWORK_INIT_H_ */
```

## src/zephyr_platform_dep.c
```c
/*
 * Licensed to Systerel under one or more contributor license
 * agreements. See the NOTICE file distributed with this work
 * for additional information regarding copyright ownership.
 * Systerel licenses this file to you under the Apache
 * License, Version 2.0 (the "License"); you may not use this
 * file except in compliance with the License. You may obtain
 * a copy of the License at
 *
 *   http://www.apache.org/licenses/LICENSE-2.0
 *
 * Unless required by applicable law or agreed to in writing,
 * software distributed under the License is distributed on an
 * "AS IS" BASIS, WITHOUT WARRANTIES OR CONDITIONS OF ANY
 * KIND, either express or implied.  See the License for the
 * specific language governing permissions and limitations
 * under the License.
 */

/** \file samples_platform_dep.c
 *
 * \brief Provides the implementation for Zephyr of OS-dependant features required for samples
 */

#include "samples_platform_dep.h"
#include "threading_alt.h"
#include "zephyr_network_init.h"

#include <stdint.h>
#include <stdio.h>

#include <zephyr/kernel.h>
#include <zephyr/net/net_if.h>
#include <zephyr/shell/shell.h>
#include <zephyr/sys/reboot.h>

#include "sopc_assert.h"
#include "sopc_macros.h"
#include "sopc_mem_alloc.h"
#include "sopc_mutexes.h"
#include "sopc_toolkit_config.h"

#if !CONFIG_SHELL
#error "This sample requires CONFIG_SHELL to be set in Zephyr project configuration"
#endif

/***************************************************/
/************ LOCAL FUNCTIONS **********************/
/***************************************************/
#define SHELL_CMD_SIZE 64
static char* shell_command = NULL;
static SOPC_Condition shell_cond;
static SOPC_Mutex shell_mutex;
static int shell_sopc_exec(const struct shell* shell, size_t argc, char** argv);
static char* cstring_array_to_string(size_t argc, char** argv);

/***************************************************/
/************ EXTERN FUNCTIONS *********************/
/***************************************************/

/***************************************************/
void SOPC_Platform_Setup(void)
{
    // Setup network
    bool netInit = Network_Initialize(NULL);
    SOPC_ASSERT(netInit == true);

#if S2OPC_CRYPTO_MBEDTLS
    /* Initialize MbedTLS */
    tls_threading_initialize();
#endif

    // Create a Thread to receive SHELL readline
    SOPC_Condition_Init(&shell_cond);
    SOPC_Mutex_Initialization(&shell_mutex);

    printk("+--------------------------------------------------------------\n");
    printk("| S2OPC sample CLI is integrated into ZEPHYR native SHELL     |\n");
    printk("| Call the ZEPHYR shell command 'sopc' to access demo control |\n");
    printk("+--------------------------------------------------------------\n");
}

/* Creating root (level 0) command "sopc" */
SHELL_CMD_REGISTER(sopc, NULL, "S2OPC demo commands", &shell_sopc_exec);

/***************************************************/
/**
 * \param argv The string array
 * \param argc The size of argv
 * \return a new allocated string containing the concatenation of all argv,
 *  separated by a space
 */
static char* cstring_array_to_string(size_t argc, char** argv)
{
    if (argc < 2)
    {
        return SOPC_Calloc(1, 1);
    }

    size_t len = argc; // argc-1 spaces + 1 char for \0
    for (size_t i = 1; i < argc; i++)
    {
        len += strlen(argv[i]);
    }
    char* result = (char*) SOPC_Calloc(len, 1);
    char* tmp = result;
    int nb = sprintf(tmp, "%s", argv[1]);
    tmp += nb;
    for (size_t i = 2; i < argc; i++)
    {
        nb = sprintf(tmp, " %s", argv[i]);
        tmp += nb;
    }

    return result;
}

/***************************************************/
char* SOPC_Shell_ReadLine(void)
{
    SOPC_Mutex_Lock(&shell_mutex);
    SOPC_Mutex_UnlockAndWaitCond(&shell_cond, &shell_mutex);
    // transfer shell_command to result
    char* result = shell_command;
    shell_command = NULL;
    SOPC_Mutex_Unlock(&shell_mutex);
    printk("\n");
    return result;
}

/***************************************************/
static int shell_sopc_exec(const struct shell* shell, size_t argc, char** argv)
{
    SOPC_Mutex_Lock(&shell_mutex);
    SOPC_Free(shell_command);
    shell_command = cstring_array_to_string(argc, argv);
    SOPC_ASSERT(NULL != shell_command);
    SOPC_Condition_SignalAll(&shell_cond);
    SOPC_Mutex_Unlock(&shell_mutex);
    return 0;
}

/***************************************************/
void SOPC_Platform_Shutdown(const bool reboot)
{
    if (reboot)
    {
        printk("\n# Rebooting in 5 seconds...\n\n");
        SOPC_Sleep(5000);
        sys_reboot(SYS_REBOOT_COLD);
    }
}

/***************************************************/
const char* SOPC_Platform_Get_Default_Net_Itf(void)
{
    struct net_if* iface = net_if_get_default();
    if (NULL != iface && NULL != iface->if_dev && NULL != iface->if_dev->dev && NULL != iface->if_dev->dev->name)
    {
        return iface->if_dev->dev->name;
    }
    return "";
}

/***************************************************/
void SOPC_Platform_Target_Debug(const char* param)
{
    SOPC_UNUSED_ARG(param);
    // Display stack instrumentation status
    const uint32_t nbSec = k_uptime_get_32() / 1000;
    printk("\n=======\nUptime: t=%d m %d s\n", nbSec / 60, nbSec % 60);
#ifdef CONFIG_SYS_HEAP_RUNTIME_STATS
    extern struct k_heap _system_heap;

    struct sys_memory_stats stats;
    int res = sys_heap_runtime_stats_get(&_system_heap.heap, &stats);
    if (res == 0)
    {
        const size_t total = stats.free_bytes + stats.allocated_bytes;
        printk("HEAP Statistics: TOTAL = %u Kb, FREE = %u Kb, maxUsed = %u Kb\n", total / 1024, stats.free_bytes / 1024,
               stats.max_allocated_bytes / 1024);
    }
#else
    printk(
        "HEAP Statistics: Data unavailable. Set flag CONFIG_SYS_HEAP_RUNTIME_STATS to 'y' to enable this feature.\n");
#endif
}

/***************************************************/
int main(void)
{
    SOPC_Platform_Main();
    return 0;
}
```

## src/zephyr_platform_info.c
```c
/*
 * Licensed to Systerel under one or more contributor license
 * agreements. See the NOTICE file distributed with this work
 * for additional information regarding copyright ownership.
 * Systerel licenses this file to you under the Apache
 * License, Version 2.0 (the "License"); you may not use this
 * file except in compliance with the License. You may obtain
 * a copy of the License at
 *
 *   http://www.apache.org/licenses/LICENSE-2.0
 *
 * Unless required by applicable law or agreed to in writing,
 * software distributed under the License is distributed on an
 * "AS IS" BASIS, WITHOUT WARRANTIES OR CONDITIONS OF ANY
 * KIND, either express or implied.  See the License for the
 * specific language governing permissions and limitations
 * under the License.
 */

#include "sopc_common_build_info.h"
#include "sopc_version.h"

static const SOPC_Build_Info sopc_client_server_build_info = {.buildVersion = SOPC_TOOLKIT_VERSION,
                                                              .buildSrcCommit = BUILD_SRC_COMMIT,
                                                              .buildDockerId = BUILD_DOCKER_ID,
                                                              .buildBuildDate = BUILD_BUILD_DATE};

/***************************************************/
SOPC_Build_Info SOPC_ClientServer_GetBuildInfo()
{
    return sopc_client_server_build_info;
}

/***************************************************/
/* Note : could also be generated automatically
 * See scripts/gen_build_info_file.sh for linux example */
SOPC_Build_Info SOPC_Common_GetBuildInfo()
{
    return sopc_client_server_build_info;
}
```
