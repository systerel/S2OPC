## CMakeLists.txt
```
# SPDX-License-Identifier: Apache-2.0

cmake_minimum_required(VERSION 3.13.1)
include($ENV{ZEPHYR_BASE}/cmake/app/boilerplate.cmake NO_POLICY_SCOPE)
project(pubsub_test_server)

add_definitions (-DWITH_STATIC_SECURITY_DATA=1 -DPUBSUB_STATIC_CONFIG=1 -DWITH_NANO_EXTENDED=1)
add_definitions (-DPUBLISH_PERIOD=1000 -DSUBSCRIBE_PERIOD=1000)

# add_definitions (-DDEBUG_PUBSUB_SCHEDULER_INFO=1)
# Add TEST include directory

SET(app_headers ${CMAKE_CURRENT_SOURCE_DIR}/src)

target_include_directories(app PRIVATE ${app_headers})

# =====================
# MBEDTLS SPECIFIC DEFS
# =====================

# custom config file
SET(mbedtls_config ${CMAKE_CURRENT_SOURCE_DIR}/src/tls_config)
target_include_directories(app PRIVATE ${tls_config})
zephyr_include_directories(${mbedtls_config})

FILE(GLOB tls_files ${CMAKE_CURRENT_SOURCE_DIR}/src/tls_config/*.c)
target_sources(app PRIVATE ${tls_files})

# ============================
# END OF MBEDTLS SPECIFIC DEFS
# ============================

# Add PUBSUB APPS includes directories

FILE(GLOB app_headers_pubsub_src_apps_pubsub_server ${CMAKE_CURRENT_SOURCE_DIR}/../../pubsub_server)

target_include_directories(app PRIVATE ${app_headers_pubsub_src_apps_pubsub_server})


# Add PUBSUB APPS sources directories

FILE(GLOB app_sources_pubsub_src_apps_pubsub_server_helpers_c ${CMAKE_CURRENT_SOURCE_DIR}/../../pubsub_server/helpers.c)

target_sources(app PRIVATE ${app_sources_pubsub_src_apps_pubsub_server_helpers_c})

FILE(GLOB app_sources_pubsub_src_apps_pubsub_server_pubsub_c ${CMAKE_CURRENT_SOURCE_DIR}/../../pubsub_server/pubsub.c)

target_sources(app PRIVATE ${app_sources_pubsub_src_apps_pubsub_server_pubsub_c})

FILE(GLOB app_sources_pubsub_src_apps_pubsub_server_server_c ${CMAKE_CURRENT_SOURCE_DIR}/../../pubsub_server/server.c)

target_sources(app PRIVATE ${app_sources_pubsub_src_apps_pubsub_server_server_c})


# Add TEST source directory

FILE(GLOB app_sources ${CMAKE_CURRENT_SOURCE_DIR}/src/*.c)


target_sources(app PRIVATE ${app_sources})

# Add other path.
set(gen_dir ${ZEPHYR_BINARY_DIR}/include/generated/)
```

## prj.conf
```kconfig
# General config
CONFIG_NEWLIB_LIBC=y
CONFIG_MAIN_STACK_SIZE=8192

CONFIG_SOCKS=y
CONFIG_POSIX_MAX_FDS=16
CONFIG_INIT_STACKS=y

# Networking config

CONFIG_NETWORKING=y
CONFIG_NET_IPV4=y
CONFIG_NET_TCP=y
CONFIG_NET_SOCKETS=y
CONFIG_NET_SOCKETS_POSIX_NAMES=y
CONFIG_NET_SOCKETS_POLL_MAX=5

CONFIG_NET_L2_DUMMY=y
CONFIG_NET_L2_ETHERNET=y
CONFIG_NET_LOOPBACK=y
CONFIG_NET_ARP=y
CONFIG_NET_MGMT=y
CONFIG_DNS_RESOLVER=y

CONFIG_NET_DEFAULT_IF_ETHERNET=y
CONFIG_NET_MAX_CONN=16
CONFIG_NET_MAX_CONTEXTS=16
CONFIG_NET_TX_STACK_SIZE=1500

CONFIG_NET_IF_MAX_IPV4_COUNT=2
CONFIG_NET_IF_MCAST_IPV4_ADDR_COUNT=16
CONFIG_NET_BUF_DATA_SIZE=512

# Network driver config
CONFIG_TEST_RANDOM_GENERATOR=y

# Network address config

CONFIG_NET_CONFIG_SETTINGS=y
CONFIG_NET_CONFIG_NEED_IPV4=y
CONFIG_NET_PROMISCUOUS_MODE=y

CONFIG_NET_CONFIG_MY_IPV4_ADDR="192.0.2.101"
CONFIG_NET_CONFIG_MY_IPV4_NETMASK="255.255.255.0"
CONFIG_NET_CONFIG_MY_IPV4_GW="192.0.2.2"

CONFIG_PUBLISHER_ADDRESS="232.1.2.100:4840"
CONFIG_SUBSCRIBER_ADDRESS="232.1.2.101:4840"

CONFIG_ETH_NATIVE_POSIX_DRV_NAME="zeth"
CONFIG_ETH_NATIVE_POSIX_RANDOM_MAC=n
CONFIG_ETH_NATIVE_POSIX_MAC_ADDR="00:00:00:00:00:03"

CONFIG_ETH_SAM_GMAC_MAC_I2C_EEPROM=n
CONFIG_ETH_SAM_GMAC_MAC_STATIC="00:00:00:01:01:01"

# MbedTLS
CONFIG_MBEDTLS=y
CONFIG_MBEDTLS_DTLS=y
CONFIG_MBEDTLS_GENPRIME_ENABLED=y
CONFIG_MBEDTLS_HEAP_SIZE=60000
CONFIG_MBEDTLS_HMAC_DRBG_ENABLED=y
CONFIG_MBEDTLS_ENTROPY_ENABLED=y
CONFIG_MBEDTLS_ENABLE_HEAP=y
CONFIG_MBEDTLS_KEY_EXCHANGE_PSK_ENABLED=y
CONFIG_MBEDTLS_KEY_EXCHANGE_RSA_PSK_ENABLED=y
CONFIG_MBEDTLS_PEM_CERTIFICATE_FORMAT=y
CONFIG_MBEDTLS_SSL_EXPORT_KEYS=y
CONFIG_MBEDTLS_SSL_MAX_CONTENT_LEN=2048
CONFIG_MBEDTLS_TLS_VERSION_1_0=y
CONFIG_MBEDTLS_TLS_VERSION_1_1=y

CONFIG_MBEDTLS_USER_CONFIG_ENABLE=y
CONFIG_MBEDTLS_USER_CONFIG_FILE="config_custom_mbedtls.h"

# S2OPC
CONFIG_S2OPC=y
 
```

## overlay_gm.conf
```kconfig
CONFIG_NET_GPTP_GM_CAPABLE=y
CONFIG_NET_GPTP_NEIGHBOR_PROP_DELAY_THR=200000

# gPTP settings
CONFIG_NET_GPTP=y
CONFIG_NET_GPTP_STATISTICS=y

# Enable these if you want to run gPTP over a VLAN link
#CONFIG_NET_GPTP_VLAN=y
#CONFIG_NET_GPTP_VLAN_TAG=100

# How many traffic classes to enable
CONFIG_NET_TC_TX_COUNT=6
CONFIG_NET_TC_RX_COUNT=4

# Enable priority support in net_context
CONFIG_NET_CONTEXT_PRIORITY=y
```

## overlay_slave.conf
```kconfig
CONFIG_NET_GPTP_GM_CAPABLE=n

CONFIG_NET_GPTP_NEIGHBOR_PROP_DELAY_THR=200000

# gPTP settings
CONFIG_NET_GPTP=y
CONFIG_NET_GPTP_STATISTICS=y

# Enable these if you want to run gPTP over a VLAN link
#CONFIG_NET_GPTP_VLAN=y
#CONFIG_NET_GPTP_VLAN_TAG=100

# How many traffic classes to enable
CONFIG_NET_TC_TX_COUNT=6
CONFIG_NET_TC_RX_COUNT=4

# Enable priority support in net_context
CONFIG_NET_CONTEXT_PRIORITY=y
```

## prj.pub.conf
```kconfig
# General config
CONFIG_NEWLIB_LIBC=y
CONFIG_MAIN_STACK_SIZE=8192

CONFIG_SOCKS=y
CONFIG_POSIX_MAX_FDS=16
CONFIG_INIT_STACKS=y

# Networking config

CONFIG_NETWORKING=y
CONFIG_NET_IPV4=y
CONFIG_NET_TCP=y
CONFIG_NET_SOCKETS=y
CONFIG_NET_SOCKETS_POSIX_NAMES=y
CONFIG_NET_SOCKETS_POLL_MAX=5

CONFIG_NET_L2_DUMMY=y
CONFIG_NET_L2_ETHERNET=y
CONFIG_NET_LOOPBACK=y
CONFIG_NET_ARP=y
CONFIG_NET_MGMT=y
CONFIG_DNS_RESOLVER=y

CONFIG_NET_DEFAULT_IF_ETHERNET=y
CONFIG_NET_MAX_CONN=16
CONFIG_NET_MAX_CONTEXTS=16
CONFIG_NET_TX_STACK_SIZE=1500

CONFIG_NET_IF_MAX_IPV4_COUNT=2
CONFIG_NET_IF_MCAST_IPV4_ADDR_COUNT=16
CONFIG_NET_BUF_DATA_SIZE=512

# Network driver config
CONFIG_TEST_RANDOM_GENERATOR=y

# Network address config

CONFIG_NET_CONFIG_SETTINGS=y
CONFIG_NET_CONFIG_NEED_IPV4=y
CONFIG_NET_PROMISCUOUS_MODE=y

CONFIG_NET_CONFIG_MY_IPV4_ADDR="192.0.2.100"
CONFIG_NET_CONFIG_MY_IPV4_NETMASK="255.255.255.0"
CONFIG_NET_CONFIG_MY_IPV4_GW="192.0.2.2"

CONFIG_PUBLISHER_ADDRESS="232.1.2.100:4840"
CONFIG_SUBSCRIBER_ADDRESS="232.1.2.101:4840"

CONFIG_ETH_NATIVE_POSIX_DRV_NAME="zeth"
CONFIG_ETH_NATIVE_POSIX_RANDOM_MAC=n
CONFIG_ETH_NATIVE_POSIX_MAC_ADDR="00:00:5e:00:53:01"

# MbedTLS
CONFIG_MBEDTLS=y
CONFIG_MBEDTLS_DTLS=y
CONFIG_MBEDTLS_GENPRIME_ENABLED=y
CONFIG_MBEDTLS_HEAP_SIZE=60000
CONFIG_MBEDTLS_HMAC_DRBG_ENABLED=y
CONFIG_MBEDTLS_ENTROPY_ENABLED=y
CONFIG_MBEDTLS_ENABLE_HEAP=y
CONFIG_MBEDTLS_KEY_EXCHANGE_PSK_ENABLED=y
CONFIG_MBEDTLS_KEY_EXCHANGE_RSA_PSK_ENABLED=y
CONFIG_MBEDTLS_PEM_CERTIFICATE_FORMAT=y
CONFIG_MBEDTLS_SSL_EXPORT_KEYS=y
CONFIG_MBEDTLS_SSL_MAX_CONTENT_LEN=2048
CONFIG_MBEDTLS_TLS_VERSION_1_0=y
CONFIG_MBEDTLS_TLS_VERSION_1_1=y

CONFIG_MBEDTLS_USER_CONFIG_ENABLE=y
CONFIG_MBEDTLS_USER_CONFIG_FILE="config_custom_mbedtls.h"

# S2OPC
CONFIG_S2OPC=y
```

## prj.sub.conf
```kconfig
# General config
CONFIG_NEWLIB_LIBC=y
CONFIG_MAIN_STACK_SIZE=8192

CONFIG_SOCKS=y
CONFIG_POSIX_MAX_FDS=16
CONFIG_INIT_STACKS=y

# Networking config

CONFIG_NETWORKING=y
CONFIG_NET_IPV4=y
CONFIG_NET_TCP=y
CONFIG_NET_SOCKETS=y
CONFIG_NET_SOCKETS_POSIX_NAMES=y
CONFIG_NET_SOCKETS_POLL_MAX=5

CONFIG_NET_L2_DUMMY=y
CONFIG_NET_L2_ETHERNET=y
CONFIG_NET_LOOPBACK=y
CONFIG_NET_ARP=y
CONFIG_NET_MGMT=y
CONFIG_DNS_RESOLVER=y

CONFIG_NET_DEFAULT_IF_ETHERNET=y
CONFIG_NET_MAX_CONN=16
CONFIG_NET_MAX_CONTEXTS=16
CONFIG_NET_TX_STACK_SIZE=1500

CONFIG_NET_IF_MAX_IPV4_COUNT=2
CONFIG_NET_IF_MCAST_IPV4_ADDR_COUNT=16
CONFIG_NET_BUF_DATA_SIZE=512

# Network driver config
CONFIG_TEST_RANDOM_GENERATOR=y

# Network address config

CONFIG_NET_CONFIG_SETTINGS=y
CONFIG_NET_CONFIG_NEED_IPV4=y
CONFIG_NET_PROMISCUOUS_MODE=y

CONFIG_NET_CONFIG_MY_IPV4_ADDR="192.0.2.101"
CONFIG_NET_CONFIG_MY_IPV4_NETMASK="255.255.255.0"
CONFIG_NET_CONFIG_MY_IPV4_GW="192.0.2.2"

CONFIG_PUBLISHER_ADDRESS="232.1.2.100:4840"
CONFIG_SUBSCRIBER_ADDRESS="232.1.2.101:4840"

CONFIG_ETH_NATIVE_POSIX_DRV_NAME="zeth"
CONFIG_ETH_NATIVE_POSIX_RANDOM_MAC=n
CONFIG_ETH_NATIVE_POSIX_MAC_ADDR="00:00:5e:00:53:01"

# MbedTLS
CONFIG_MBEDTLS=y
CONFIG_MBEDTLS_DTLS=y
CONFIG_MBEDTLS_GENPRIME_ENABLED=y
CONFIG_MBEDTLS_HEAP_SIZE=60000
CONFIG_MBEDTLS_HMAC_DRBG_ENABLED=y
CONFIG_MBEDTLS_ENTROPY_ENABLED=y
CONFIG_MBEDTLS_ENABLE_HEAP=y
CONFIG_MBEDTLS_KEY_EXCHANGE_PSK_ENABLED=y
CONFIG_MBEDTLS_KEY_EXCHANGE_RSA_PSK_ENABLED=y
CONFIG_MBEDTLS_PEM_CERTIFICATE_FORMAT=y
CONFIG_MBEDTLS_SSL_EXPORT_KEYS=y
CONFIG_MBEDTLS_SSL_MAX_CONTENT_LEN=2048
CONFIG_MBEDTLS_TLS_VERSION_1_0=y
CONFIG_MBEDTLS_TLS_VERSION_1_1=y

CONFIG_MBEDTLS_USER_CONFIG_ENABLE=y
CONFIG_MBEDTLS_USER_CONFIG_FILE="config_custom_mbedtls.h"

# S2OPC
CONFIG_S2OPC=y
```

## pubprj.conf
```kconfig
# General config
CONFIG_NEWLIB_LIBC=y
CONFIG_MAIN_STACK_SIZE=8192

CONFIG_SOCKS=y
CONFIG_POSIX_MAX_FDS=16
CONFIG_INIT_STACKS=y

# Networking config

CONFIG_NETWORKING=y
CONFIG_NET_IPV4=y
CONFIG_NET_TCP=y
CONFIG_NET_SOCKETS=y
CONFIG_NET_SOCKETS_POSIX_NAMES=y
CONFIG_NET_SOCKETS_POLL_MAX=5

CONFIG_NET_L2_DUMMY=y
CONFIG_NET_L2_ETHERNET=y
CONFIG_NET_LOOPBACK=y
CONFIG_NET_ARP=y
CONFIG_NET_MGMT=y
CONFIG_DNS_RESOLVER=y

CONFIG_NET_DEFAULT_IF_ETHERNET=y
CONFIG_NET_MAX_CONN=16
CONFIG_NET_MAX_CONTEXTS=16
CONFIG_NET_TX_STACK_SIZE=1500

CONFIG_NET_IF_MAX_IPV4_COUNT=2
CONFIG_NET_IF_MCAST_IPV4_ADDR_COUNT=16
CONFIG_NET_BUF_DATA_SIZE=512

# Network driver config
CONFIG_TEST_RANDOM_GENERATOR=y

# Network address config

CONFIG_NET_CONFIG_SETTINGS=y
CONFIG_NET_CONFIG_NEED_IPV4=y
CONFIG_NET_PROMISCUOUS_MODE=y

CONFIG_NET_CONFIG_MY_IPV4_ADDR="192.0.2.100"
CONFIG_NET_CONFIG_MY_IPV4_NETMASK="255.255.255.0"
CONFIG_NET_CONFIG_MY_IPV4_GW="192.0.2.2"

CONFIG_PUBLISHER_ADDRESS="232.1.2.100:4840"
CONFIG_SUBSCRIBER_ADDRESS="232.1.2.101:4840"

CONFIG_ETH_SAM_GMAC_MAC_I2C_EEPROM=n
CONFIG_ETH_SAM_GMAC_MAC_STATIC="00:00:00:01:01:01"

# MbedTLS
CONFIG_MBEDTLS=y
CONFIG_MBEDTLS_DTLS=y
CONFIG_MBEDTLS_GENPRIME_ENABLED=y
CONFIG_MBEDTLS_HEAP_SIZE=60000
CONFIG_MBEDTLS_HMAC_DRBG_ENABLED=y
CONFIG_MBEDTLS_ENTROPY_ENABLED=y
CONFIG_MBEDTLS_ENABLE_HEAP=y
CONFIG_MBEDTLS_KEY_EXCHANGE_PSK_ENABLED=y
CONFIG_MBEDTLS_KEY_EXCHANGE_RSA_PSK_ENABLED=y
CONFIG_MBEDTLS_PEM_CERTIFICATE_FORMAT=y
CONFIG_MBEDTLS_SSL_EXPORT_KEYS=y
CONFIG_MBEDTLS_SSL_MAX_CONTENT_LEN=2048
CONFIG_MBEDTLS_TLS_VERSION_1_0=y
CONFIG_MBEDTLS_TLS_VERSION_1_1=y

CONFIG_MBEDTLS_USER_CONFIG_ENABLE=y
CONFIG_MBEDTLS_USER_CONFIG_FILE="config_custom_mbedtls.h"

# S2OPC
CONFIG_S2OPC=y
 
```

## subprj.conf
```kconfig
# General config
CONFIG_NEWLIB_LIBC=y
CONFIG_MAIN_STACK_SIZE=8192

CONFIG_SOCKS=y
CONFIG_POSIX_MAX_FDS=16
CONFIG_INIT_STACKS=y

# Networking config

CONFIG_NETWORKING=y
CONFIG_NET_IPV4=y
CONFIG_NET_TCP=y
CONFIG_NET_SOCKETS=y
CONFIG_NET_SOCKETS_POSIX_NAMES=y
CONFIG_NET_SOCKETS_POLL_MAX=5

CONFIG_NET_L2_DUMMY=y
CONFIG_NET_L2_ETHERNET=y
CONFIG_NET_LOOPBACK=y
CONFIG_NET_ARP=y
CONFIG_NET_MGMT=y
CONFIG_DNS_RESOLVER=y

CONFIG_NET_DEFAULT_IF_ETHERNET=y
CONFIG_NET_MAX_CONN=16
CONFIG_NET_MAX_CONTEXTS=16
CONFIG_NET_TX_STACK_SIZE=1500

CONFIG_NET_IF_MAX_IPV4_COUNT=2
CONFIG_NET_IF_MCAST_IPV4_ADDR_COUNT=16
CONFIG_NET_BUF_DATA_SIZE=512

# Network driver config
CONFIG_TEST_RANDOM_GENERATOR=y

# Network address config

CONFIG_NET_CONFIG_SETTINGS=y
CONFIG_NET_CONFIG_NEED_IPV4=y
CONFIG_NET_PROMISCUOUS_MODE=y

CONFIG_NET_CONFIG_MY_IPV4_ADDR="192.0.2.101"
CONFIG_NET_CONFIG_MY_IPV4_NETMASK="255.255.255.0"
CONFIG_NET_CONFIG_MY_IPV4_GW="192.0.2.2"

CONFIG_PUBLISHER_ADDRESS="232.1.2.100:4840"
CONFIG_SUBSCRIBER_ADDRESS="232.1.2.101:4840"

CONFIG_ETH_SAM_GMAC_MAC_I2C_EEPROM=n
CONFIG_ETH_SAM_GMAC_MAC_STATIC="00:00:00:02:02:02"

# MbedTLS
CONFIG_MBEDTLS=y
CONFIG_MBEDTLS_DTLS=y
CONFIG_MBEDTLS_GENPRIME_ENABLED=y
CONFIG_MBEDTLS_HEAP_SIZE=60000
CONFIG_MBEDTLS_HMAC_DRBG_ENABLED=y
CONFIG_MBEDTLS_ENTROPY_ENABLED=y
CONFIG_MBEDTLS_ENABLE_HEAP=y
CONFIG_MBEDTLS_KEY_EXCHANGE_PSK_ENABLED=y
CONFIG_MBEDTLS_KEY_EXCHANGE_RSA_PSK_ENABLED=y
CONFIG_MBEDTLS_PEM_CERTIFICATE_FORMAT=y
CONFIG_MBEDTLS_SSL_EXPORT_KEYS=y
CONFIG_MBEDTLS_SSL_MAX_CONTENT_LEN=2048
CONFIG_MBEDTLS_TLS_VERSION_1_0=y
CONFIG_MBEDTLS_TLS_VERSION_1_1=y

CONFIG_MBEDTLS_USER_CONFIG_ENABLE=y
CONFIG_MBEDTLS_USER_CONFIG_FILE="config_custom_mbedtls.h"

# S2OPC
CONFIG_S2OPC=y
 
```

## src/network_init.c
```c
/*
 * Licensed to Systerel under one or more contributor license
 * agreements. See the NOTICE file distributed with this work
 * for additional information regarding copyright ownership.
 * Systerel licenses this file to you under the Apache
 * License, Version 2.0 (the "License"); you may not use this
 * file except in compliance with the License. You may obtain
 * a copy of the License at
 *
 *   http://www.apache.org/licenses/LICENSE-2.0
 *
 * Unless required by applicable law or agreed to in writing,
 * software distributed under the License is distributed on an
 * "AS IS" BASIS, WITHOUT WARRANTIES OR CONDITIONS OF ANY
 * KIND, either express or implied.  See the License for the
 * specific language governing permissions and limitations
 * under the License.
 */

#include "network_init.h"

#include <assert.h>
#include <errno.h>
#include <inttypes.h>
#include <kernel.h>
#include <limits.h>

#include <stdbool.h>
#include <stdint.h>
#include <stdio.h>
#include <stdlib.h>

#include <fcntl.h>
#include <kernel.h>
#include <net/net_ip.h>
#include <net/socket.h>
#include "net/ethernet.h"
#include "net/net_if.h"

#include "sopc_mutexes.h"

#ifndef MY_IP_LB
#define MY_IP_LB ((const char*) ("127.0.0.1"))
#endif

#ifndef MY_IP_LB_MASK
#define MY_IP_LB_MASK ((const char*) ("255.255.255.0"))
#endif

#ifndef CONFIG_NET_CONFIG_MY_IPV4_ADDR
#define CONFIG_NET_CONFIG_MY_IPV4_ADDR ((const char*) ("192.168.1.102"))
#endif

#ifndef CONFIG_NET_CONFIG_MY_IPV4_NETMASK
#define CONFIG_NET_CONFIG_MY_IPV4_NETMASK ((const char*) ("255.255.255.0"))
#endif

#ifndef CONFIG_NET_CONFIG_MY_IPV4_GW
#define CONFIG_NET_CONFIG_MY_IPV4_GW ((const char*) ("192.168.1.111"))
#endif

typedef enum E_NETWORK_CONFIG_STATUS
{
    NETWORK_CONFIG_STATUS_NOT_INITIALIZED,
    NETWORK_CONFIG_STATUS_INITIALIZING,
    NETWORK_CONFIG_STATUS_INITIALIZED,
    NETWORK_CONFIG_STATUS_SIZE = INT32_MAX
} eNetworkConfigStatus;

/* Max socket based on max connections allowed by zephyr */

#ifdef CONFIG_NET_MAX_CONN
#define MAX_ZEPHYR_SOCKET (CONFIG_NET_MAX_CONN - 2)
#else
#define MAX_ZEPHYR_SOCKET 4
#endif

static volatile eNetworkConfigStatus priv_P_SOCKET_networkConfigStatus = NETWORK_CONFIG_STATUS_NOT_INITIALIZED;

static Mutex priv_lockL2; // tabMCast protection

// *** Weak p_sockets functions definitions ***

bool Network_Initialize(void)
{
    uint32_t nwStatus = 0;

    printk("\r\nNetwork initialize called\r\n");

    do
    {
        nwStatus = __sync_val_compare_and_swap(&priv_P_SOCKET_networkConfigStatus,    //
                                               NETWORK_CONFIG_STATUS_NOT_INITIALIZED, // Not initialized
                                               NETWORK_CONFIG_STATUS_INITIALIZING);   // Initializing

        if (0 == nwStatus)
        {
            assert(SOPC_STATUS_OK == Mutex_Initialization(&priv_lockL2));

            struct net_if* ptrNetIf = NULL;
            struct in_addr addressLoopBack;
            struct in_addr addressLoopBackNetMask;
            struct in_addr addressInterfaceEth;
            struct in_addr addressInterfaceEthMask;
            struct in_addr addressInterfaceEthGtw;
            net_addr_pton(AF_INET, MY_IP_LB, (void*) &addressLoopBack);
            net_addr_pton(AF_INET, MY_IP_LB_MASK, (void*) &addressLoopBackNetMask);

            net_addr_pton(AF_INET, CONFIG_NET_CONFIG_MY_IPV4_ADDR, (void*) &addressInterfaceEth);
            net_addr_pton(AF_INET, CONFIG_NET_CONFIG_MY_IPV4_NETMASK, (void*) &addressInterfaceEthMask);
            net_addr_pton(AF_INET, CONFIG_NET_CONFIG_MY_IPV4_GW, (void*) &addressInterfaceEthGtw);
            if (NULL == net_if_ipv4_addr_lookup(&addressLoopBack, &ptrNetIf))
            {
#if defined(CONFIG_NET_L2_DUMMY)
                ptrNetIf = net_if_get_first_by_type(&NET_L2_GET_NAME(DUMMY));
#else
#error "CONFIG_NET_L2_DUMMY should be defined."
#endif
                assert(NULL != ptrNetIf);
                assert(NULL != net_if_ipv4_addr_add(ptrNetIf, &addressLoopBack, NET_ADDR_MANUAL, 0));
                net_if_ipv4_set_netmask(ptrNetIf, &addressLoopBackNetMask);
            }

            if (NULL == net_if_ipv4_addr_lookup(&addressInterfaceEth, &ptrNetIf))
            {
#if defined(CONFIG_NET_L2_ETHERNET)
                ptrNetIf = net_if_get_first_by_type(&NET_L2_GET_NAME(ETHERNET));
#else
#error "CONFIG_NET_L2_ETHERNET should be defined"
#endif
                assert(NULL != ptrNetIf);
                assert(NULL != net_if_ipv4_addr_add(ptrNetIf, &addressInterfaceEth, NET_ADDR_MANUAL, 0));
                net_if_ipv4_set_gw(ptrNetIf, &addressInterfaceEthGtw);
                net_if_ipv4_set_netmask(ptrNetIf, &addressInterfaceEthMask);
            }

            priv_P_SOCKET_networkConfigStatus = NETWORK_CONFIG_STATUS_INITIALIZED;
            nwStatus = NETWORK_CONFIG_STATUS_INITIALIZED;
        }
        else
        {
            // Initializing on going, yield and retry
            if (NETWORK_CONFIG_STATUS_INITIALIZING == nwStatus)
            {
                k_yield();
            }
        }
    } while (NETWORK_CONFIG_STATUS_INITIALIZING == nwStatus);

    // Initialized or not initialized
    if (NETWORK_CONFIG_STATUS_INITIALIZED == nwStatus)
    {
        return true;
    }
    else
    {
        return false;
    }
}
```

## src/pubsub_config_static.c
```c
/* Copyright (C) Systerel SAS 2019, all rights reserved. */

#include "pubsub_config_static.h"

#include <assert.h>
#include <stdbool.h>
#include <string.h>



static SOPC_DataSetWriter* SOPC_PubSubConfig_SetPubMessageAt(SOPC_PubSubConnection* connection,
                                                             uint16_t index,
                                                             uint16_t messageId,
                                                             uint32_t version,
                                                             uint64_t interval,
                                                             SOPC_SecurityMode_Type securityMode)
{
    SOPC_WriterGroup* group = SOPC_PubSubConnection_Get_WriterGroup_At(connection, index);
    SOPC_WriterGroup_Set_Id(group, messageId);
    SOPC_WriterGroup_Set_Version(group, version);
    SOPC_WriterGroup_Set_PublishingInterval(group, interval);
    SOPC_WriterGroup_Set_SecurityMode(group, securityMode);

    // Create one DataSet Writer
    SOPC_WriterGroup_Allocate_DataSetWriter_Array(group, 1);
    SOPC_DataSetWriter* writer = SOPC_WriterGroup_Get_DataSetWriter_At(group, 0);
    SOPC_DataSetWriter_Set_Id(writer, messageId);
    return writer;
}



static SOPC_PublishedDataSet* SOPC_PubSubConfig_InitDataSet(SOPC_PubSubConfiguration* config,
                                                            uint16_t dataSetIndex,
                                                            SOPC_DataSetWriter* writer,
                                                            uint16_t nbVar)
{
    SOPC_PublishedDataSet* dataset = SOPC_PubSubConfiguration_Get_PublishedDataSet_At(config, dataSetIndex);
    SOPC_PublishedDataSet_Init(dataset, SOPC_PublishedDataItemsDataType, nbVar);
    SOPC_DataSetWriter_Set_DataSet(writer, dataset);

    return dataset;
}


static void SOPC_PubSubConfig_SetPubVariableAt(SOPC_PublishedDataSet* dataset,
                                               uint16_t index,
                                               char* strNodeId,
                                               SOPC_BuiltinId builtinType)
{
    SOPC_FieldMetaData* fieldmetadata = SOPC_PublishedDataSet_Get_FieldMetaData_At(dataset, index);
    SOPC_FieldMetaData_Set_ValueRank(fieldmetadata, -1);
    SOPC_FieldMetaData_Set_BuiltinType(fieldmetadata, builtinType);
    SOPC_PublishedVariable* publishedVar = SOPC_FieldMetaData_Get_PublishedVariable(fieldmetadata);
    assert(NULL != publishedVar);
    SOPC_NodeId* nodeId = SOPC_NodeId_FromCString(strNodeId, (int32_t) strlen(strNodeId));
    assert(NULL != nodeId);
    SOPC_PublishedVariable_Set_NodeId(publishedVar, nodeId);
    SOPC_PublishedVariable_Set_AttributeId(publishedVar, 13); // Value => AttributeId=13
}


SOPC_PubSubConfiguration* SOPC_PubSubConfig_GetStatic(void)
{
    bool alloc = true;
    SOPC_PubSubConfiguration* config = SOPC_PubSubConfiguration_Create();
    
    SOPC_PubSubConnection* connection;
    

    /* 1 connection pub */
    alloc = SOPC_PubSubConfiguration_Allocate_PubConnection_Array(config, 1);
    
    /** connection pub 0 **/
    
    if (alloc)
    {
        // Set publisher id and address
        connection = SOPC_PubSubConfiguration_Get_PubConnection_At(config, 0);
        SOPC_PubSubConnection_Set_PublisherId_UInteger(connection, 42);
        alloc = SOPC_PubSubConnection_Set_Address(connection, "opc.udp://232.1.2.100:4840");
    }

    if (alloc)
    {
        // 2 pub messages
        alloc = SOPC_PubSubConnection_Allocate_WriterGroup_Array(connection, 2);
    }

    if (alloc)
    {
        // 2 published data sets
        alloc = SOPC_PubSubConfiguration_Allocate_PublishedDataSet_Array(config, 2);
    }

        
    /*** Pub Message 14 ***/
    
    SOPC_DataSetWriter* writer = NULL;
        
    if (alloc)
    {
        writer = SOPC_PubSubConfig_SetPubMessageAt(connection, 0, 14, 1, 100, SOPC_SecurityMode_SignAndEncrypt);
        alloc = NULL != writer;
    }
    
    SOPC_PublishedDataSet* dataset = NULL;
    
    if (alloc)
    {
        dataset = SOPC_PubSubConfig_InitDataSet(config, 0, writer, 2);
        alloc = NULL != dataset;
    }
    if (alloc)
    {
        
        SOPC_PubSubConfig_SetPubVariableAt(dataset, 0, "ns=1;s=PubBool", SOPC_Boolean_Id);
        SOPC_PubSubConfig_SetPubVariableAt(dataset, 1, "ns=1;s=PubString", SOPC_String_Id);
    }
    
    /*** Pub Message 15 ***/
    
    if (alloc)
    {
        writer = SOPC_PubSubConfig_SetPubMessageAt(connection, 1, 15, 1, 1000, SOPC_SecurityMode_None);
        alloc = NULL != writer;
    }
    
    if (alloc)
    {
        dataset = SOPC_PubSubConfig_InitDataSet(config, 1, writer, 2);
        alloc = NULL != dataset;
    }
    if (alloc)
    {
        
        SOPC_PubSubConfig_SetPubVariableAt(dataset, 0, "ns=1;s=PubInt", SOPC_Int64_Id);
        SOPC_PubSubConfig_SetPubVariableAt(dataset, 1, "ns=1;s=PubUInt", SOPC_UInt64_Id);
    }
    

    if (!alloc)
    {
        SOPC_PubSubConfiguration_Delete(config);
        return NULL;
    }

    return config;
}
    
```

## src/pubsub_test_server.c
```c
/*
 * Licensed to Systerel under one or more contributor license
 * agreements. See the NOTICE file distributed with this work
 * for additional information regarding copyright ownership.
 * Systerel licenses this file to you under the Apache
 * License, Version 2.0 (the "License"); you may not use this
 * file except in compliance with the License. You may obtain
 * a copy of the License at
 *
 *   http://www.apache.org/licenses/LICENSE-2.0
 *
 * Unless required by applicable law or agreed to in writing,
 * software distributed under the License is distributed on an
 * "AS IS" BASIS, WITHOUT WARRANTIES OR CONDITIONS OF ANY
 * KIND, either express or implied.  See the License for the
 * specific language governing permissions and limitations
 * under the License.
 */

#include <errno.h>
#include <inttypes.h>
#include <kernel.h>
#include <limits.h>

#include <assert.h>
#include <errno.h>
#include <inttypes.h>
#include <signal.h>
#include <stdbool.h>
#include <stdint.h>
#include <stdio.h>
#include <stdlib.h>
#include <string.h>

#ifndef __INT32_MAX__
#include <toolchain/xcc_missing_defs.h>
#endif

#include <fcntl.h>
#include <kernel.h>
#include <net/net_ip.h>
#include <net/socket.h>
#ifndef NULL
#define NULL ((void*) 0)
#endif

#include "opcua_identifiers.h"
#include "opcua_statuscodes.h"
#include "sopc_atomic.h"
#include "sopc_common.h"
#include "sopc_crypto_profiles.h"
#include "sopc_crypto_provider.h"
#include "sopc_encodeable.h"
#include "sopc_helper_uri.h"
#include "sopc_mem_alloc.h"
#include "sopc_mutexes.h"
#include "sopc_pki_stack.h"
#include "sopc_pub_scheduler.h"
#include "sopc_pubsub_helpers.h"
#include "sopc_raw_sockets.h"
#include "sopc_threads.h"
#include "sopc_time.h"
#include "sopc_toolkit_async_api.h"
#include "sopc_toolkit_config.h"
#include "sopc_udp_sockets.h"
#include "sopc_user_app_itf.h"
#include "sopc_user_manager.h"

#include "embedded/sopc_addspace_loader.h"
#include "network_init.h"
#include "runtime_variables.h"
#include "threading_alt.h"

#include "static_security_data.h"

#include "config.h"
#include "pubsub.h"
#include "server.h"

#define LIBC_STDOUT_BUFFER_HOOK 0

/****************************************/

#if LIBC_STDOUT_BUFFER_HOOK == 1

extern void __stdout_buffer_hook_install(void (*fn)(const char*, int));
extern void __stdout_hook_install(int (*fn)(int));

K_MUTEX_DEFINE(my_mutex);

char gBuffer[256];

static void _zephyr_callback_log_buffer_hook(const char* buffer, int size)
{
    // SOPC_LogServer_Print(0, buffer, size, false);
    k_mutex_lock(&my_mutex, K_FOREVER);
    size = size > 256 ? 256 : size;
    memset(gBuffer, 0, 256);
    memcpy(gBuffer, buffer, size);
    gBuffer[size - 1] = 0;
    (void) printk("%s\r\n", (char*) gBuffer);
    k_mutex_unlock(&my_mutex);
    return;
}

static int _zephyr_callback_log_hook(int character)
{
    if (character == '\r')
    {
        return character;
    }
    return character;
}

static int _zephyr_add_log_hook(struct device* d)
{
    ARG_UNUSED(d);
    __stdout_hook_install(_zephyr_callback_log_hook);
    __stdout_buffer_hook_install(_zephyr_callback_log_buffer_hook);
    return 0;
}

#endif

#ifndef SOPC_PUBSCHEDULER_BEATHEART_FROM_IRQ
void Pub_BeatHeart(void)
{
    SOPC_Sleep(50);
}
#endif

volatile uint32_t stopSignal = 0;

static void* callbackTest(void* pCtx)
{
    /* Signal handling: close the server gracefully when interrupted */
#if SOPC_PUBSCHEDULER_BEATHEART_FROM_IRQ == 1
    uint32_t tickValue = 0;
#endif

    int argc = 1;
    char** argv = (char**) SOPC_Calloc(1, sizeof(char*));
    assert(argv != NULL);
    argv[0] = (char*) SOPC_Calloc(1, 16);
    assert(argv[0] != NULL);
    snprintf(argv[0], 16, "%s", "toolkit_test");

    /* Parse command line arguments ? */
    if (argc > 1)
    {
        assert(argc == 2);
        int32_t tmp, tmp2, tmp3;
        bool res = SOPC_Helper_URI_ParseUri_WithPrefix("opc.tcp://", argv[1], &tmp, &tmp2, &tmp3);
        if (!res)
        {
            printf("# Error: invalid OPC UA server address\n");
            exit(1);
        }
        ENDPOINT_URL = argv[1];
    }
    else
    {
        ENDPOINT_URL = DEFAULT_ENDPOINT_URL;
    }

    /* Initialize S2OPC Server */
    SOPC_ReturnStatus status = Server_Initialize();
    if (SOPC_STATUS_OK != status)
    {
        printf("# Error: Could not initialize the server.\n");
    }

    /* Configure the Server */
    SOPC_S2OPC_Config s2opcConfig;
    SOPC_S2OPC_Config_Initialize(&s2opcConfig);

    if (SOPC_STATUS_OK == status)
    {
        status = Server_CreateServerConfig(&s2opcConfig);
        if (SOPC_STATUS_OK != status)
        {
            printf("# Error: Could not create the server configuration.\n");
        }
    }

    if (SOPC_STATUS_OK == status)
    {
        status = Server_LoadAddressSpace();
    }

    /* Configuration of the PubSub module is done upon PubSub start through the local service */

    /* Start the Server */
    if (SOPC_STATUS_OK == status)
    {
        status = Server_ConfigureStartServer(&s2opcConfig.serverConfig.endpoints[0]);
    }

    /* Write in PubSub nodes, which starts the PubSub */
    if (SOPC_STATUS_OK == status)
    {
        status = Server_WritePubSubNodes();
    }

    /* Wait for a signal */
    while (SOPC_STATUS_OK == status && Server_IsRunning() && stopSignal == 0)
    {
        //  Beat heart. Simple pause during SOPC_TIMER_RESOLUTION_MS if
        //  SOPC_PUBSCHEDULER_BEATHEART_FROM_IRQ #define is set to 0
        //  in the sopc_pub_scheduler header file.
        //  Else, SOPC_PubScheduler_BeatHeartFromIRQ is defined and called
        //  with a monotonic uint32_t counter, followed by a pause of
        //  SOPC_TIMER_RESOLTION_MS

        Pub_BeatHeart();

        if (Server_PubSubStop_Requested())
        {
            PubSub_Stop();
            printf("# Info: PubSub stopped through Start/Stop Command.\n");
        }
        if (Server_PubSubStart_Requested())
        {
            status = PubSub_Configure();
            if (SOPC_STATUS_OK == status)
            {
                printf("# Info: PubSub configured through Start/Stop Command.\n");
            }
            else
            {
                printf("# Warning: Start/Stop Command failed to configure the PubSub module.\n");
            }

            if (SOPC_STATUS_OK == status)
            {
                status = PubSub_Start() ? SOPC_STATUS_OK : SOPC_STATUS_NOK;
                if (SOPC_STATUS_NOK == status)
                {
                    PubSub_Stop(); // Ensure Pub & Sub are stopped in this case
                }
            }
            if (SOPC_STATUS_OK == status)
            {
                printf("# Info: PubSub started through Start/Stop Command.\n");
            }
            else
            {
                printf("# Warning: Start/Stop Command failed to start the PubSub module.\n");
            }
        }
        if (SOPC_STATUS_OK != status)
        {
            printf("# Warning: waiting for a new configure + start command !\n");
            status = SOPC_STATUS_OK;
        }
    }

    /* Clean and quit */
    PubSub_StopAndClear();
    Server_StopAndClear(&s2opcConfig);
    printf("# Info: Server closed.\n");
    return NULL;
}

static void TEST_LAUNCH(void)
{
    SOPC_ReturnStatus result;
#if LIBC_STDOUT_BUFFER_HOOK == 1
    _zephyr_add_log_hook(NULL);
#endif

    bool netInit = Network_Initialize();
    assert(netInit == true);

    /* Initialize MbedTLS */
    tls_threading_initialize();

    Thread sopcThreadHandle1 = NULL;

    printk("\r\nReady to launch application :)\r\n");

    result = SOPC_Thread_Create(&sopcThreadHandle1, callbackTest, NULL, NULL);
    assert(SOPC_STATUS_OK == result);

    SOPC_Thread_Join(sopcThreadHandle1);

    while (true)
    {
        printf("\r\nThread quit, error and go to idle...\r\n");
        SOPC_Sleep(1000);
    }

    return;
}

void main(void)
{
    TEST_LAUNCH();
}
```

## src/sopc_common_build_info.c
```c
/*
 * Licensed to Systerel under one or more contributor license
 * agreements. See the NOTICE file distributed with this work
 * for additional information regarding copyright ownership.
 * Systerel licenses this file to you under the Apache
 * License, Version 2.0 (the "License"); you may not use this
 * file except in compliance with the License. You may obtain
 * a copy of the License at
 *
 *   http://www.apache.org/licenses/LICENSE-2.0
 *
 * Unless required by applicable law or agreed to in writing,
 * software distributed under the License is distributed on an
 * "AS IS" BASIS, WITHOUT WARRANTIES OR CONDITIONS OF ANY
 * KIND, either express or implied.  See the License for the
 * specific language governing permissions and limitations
 * under the License.
 */

#include "sopc_common_build_info.h"
#include "sopc_version.h"

const SOPC_Build_Info sopc_common_build_info = {.buildVersion = SOPC_TOOLKIT_VERSION,
                                                .buildSrcCommit = "Unknown_Revision",
                                                .buildDockerId = "",
                                                .buildBuildDate = ""};

SOPC_Build_Info SOPC_Common_GetBuildInfo()
{
    return sopc_common_build_info;
}
```

## src/sopc_toolkit_build_info.c
```c
/*
 * Licensed to Systerel under one or more contributor license
 * agreements. See the NOTICE file distributed with this work
 * for additional information regarding copyright ownership.
 * Systerel licenses this file to you under the Apache
 * License, Version 2.0 (the "License"); you may not use this
 * file except in compliance with the License. You may obtain
 * a copy of the License at
 *
 *   http://www.apache.org/licenses/LICENSE-2.0
 *
 * Unless required by applicable law or agreed to in writing,
 * software distributed under the License is distributed on an
 * "AS IS" BASIS, WITHOUT WARRANTIES OR CONDITIONS OF ANY
 * KIND, either express or implied.  See the License for the
 * specific language governing permissions and limitations
 * under the License.
 */

#include "sopc_toolkit_build_info.h"
#include "sopc_version.h"

const SOPC_Build_Info sopc_client_server_build_info = {.buildVersion = SOPC_TOOLKIT_VERSION,
                                                       .buildSrcCommit = "Unknown_Revision",
                                                       .buildDockerId = "",
                                                       .buildBuildDate = ""};

SOPC_Build_Info SOPC_ClientServer_GetBuildInfo()
{
    return sopc_client_server_build_info;
}
```
